#include <WiFi.h>
#include <DNSServer.h>
#include <WebServer.h>
#include <Preferences.h>
Preferences preferences;
Preferences lovetv_prefs;
String PrefSSID, PrefPassword, cityCode;

const char* AP_NAME = "小电视";//Web配网模式下的AP-wifi名字

//配网页面代码
String page_html = R"x(
<!DOCTYPE html>
<html lang="en">
<head>
    <meta charset="UTF-8">
    <meta http-equiv="X-UA-Compatible" content="IE=edge">
    <meta name="viewport" content="width=device-width, initial-scale=1.0">
    <title>网络配置</title>
    <link rel="stylesheet" href="style.css">
</head>
<body>
    <form class="card" name="input" action="/" method="POST">
        <input type="text" name="ssid" autocomplete="on" maxlength="32" required placeholder="WiFi名称">
        <input type="password" name="password" autocomplete="current-password" maxlength="63" placeholder="WiFi密码（开放网络可留空）">
        <input type="text" name="cityname" autocomplete="on" required value="烟台" placeholder="城市名称" oninput="javascript:checkCity(this)">
        <input type="hidden" id="cityid" name="cityid" value="101120501">
        <input type="number" name="year" min="1970" max="2099" required value="2019" placeholder="纪念日 年（如 2019）">
        <input type="number" name="month" min="1" max="12" required value="9" placeholder="纪念日 月（如 9）">
        <input type="number" name="day" min="1" max="31" required value="1" placeholder="纪念日 日（如 1）">
        <input type="text" name="bottom" maxlength="128" value="known since 2019.9.1" placeholder="相识页底部文字（可留空）">
        <input type="text" name="self_id" maxlength="16" required value="A" placeholder="本机 ID（如 A）">
        <input type="text" name="peer_id" maxlength="16" required value="B" placeholder="对方 ID（如 B）">
        <div id="tip" class="tip">
            请输入城市名称
        </div>
        <button type="submit">保存</button>
        <div></div>
    </form>
    <script src="index.js"></script>
</body>
</html>
)x";

// style.css
String style_css = R"x(
* {
    padding: 0;
    margin: 0;
}

body {
    width: 100vw;
    min-height: 100vh;
    display: flex;
    align-items: center;
    justify-content: center;
    font-size: 16px;
}

body::before {
    content: "";
    position: fixed;
    left: 0;
    top: 0;
    right: 0;
    bottom: 0;
    opacity: 0.3;
    z-index: 0;
    background-image: url("data:image/jpeg;base64,/9j/4AAQSkZJRgABAQEAYABgAAD/2wBDAAYEBQYFBAYGBQYHBwYIChAKCgkJChQODwwQFxQYGBcUFhYaHSUfGhsjHBYWICwgIyYnKSopGR8tMC0oMCUoKSj/2wBDAQcHBwoIChMKChMoGhYaKCgoKCgoKCgoKCgoKCgoKCgoKCgoKCgoKCgoKCgoKCgoKCgoKCgoKCgoKCgoKCgoKCj/wAARCAMLAWgDASIAAhEBAxEB/8QAHwAAAQUBAQEBAQEAAAAAAAAAAAECAwQFBgcICQoL/8QAtRAAAgEDAwIEAwUFBAQAAAF9AQIDAAQRBRIhMUEGE1FhByJxFDKBkaEII0KxwRVS0fAkM2JyggkKFhcYGRolJicoKSo0NTY3ODk6Q0RFRkdISUpTVFVWV1hZWmNkZWZnaGlqc3R1dnd4eXqDhIWGh4iJipKTlJWWl5iZmqKjpKWmp6ipqrKztLW2t7i5usLDxMXGx8jJytLT1NXW19jZ2uHi4+Tl5ufo6erx8vP09fb3+Pn6/8QAHwEAAwEBAQEBAQEBAQAAAAAAAAECAwQFBgcICQoL/8QAtREAAgECBAQDBAcFBAQAAQJ3AAECAxEEBSExBhJBUQdhcRMiMoEIFEKRobHBCSMzUvAVYnLRChYkNOEl8RcYGRomJygpKjU2Nzg5OkNERUZHSElKU1RVVldYWVpjZGVmZ2hpanN0dXZ3eHl6goOEhYaHiImKkpOUlZaXmJmaoqOkpaanqKmqsrO0tba3uLm6wsPExcbHyMnK0tPU1dbX2Nna4uPk5ebn6Onq8vP09fb3+Pn6/9oADAMBAAIRAxEAPwD5vooor0TAKKKKAFp1NpapMB4paaKetMliGmtT6TFAEZpKewpuKQ0Jikp1JRYYlFLikqQCiiigAooooAKKKKAClpKKaGPU08UxacKohki06mCnKa0iwAimVLTD1okAlFFFSAjUyntTalgMagCnYpcUgExTh1opQKADODS43UuKlRcirSIchoSpVTHNSRr61YjiPpWiiYTnYbCmasKBnBqRI8DpU0ce41qonJOoNSIHtRVyGIg9KK05GcsqmpxFLijFFeafQiUUuKKAClzSUU0A4U8HFRing5piY7NFJS00IKaRxTqTFAEdFOI5pKChtGKWipsA2iloxSASiilxQAlFFFABRRS4poBaeKjp6niqEySnL0pgpwqkIdikYc06kNaNXAZRRRWYCGjFKRRSAbilAooBpWELjHSnAUKCRT1XNNIlyEUVYiX1pqpirESVpFGM5ksUVWo1pIEOKnCZPAroikcU5gik8VahjwaIITnPWtS1hBPK81vCm2clSTGW8GetFasduo5xRXWqaSOSWrPIsUtFFfPWPrhKMUtFACdKKWimgEpaKMUAOzTh0plOU0CaHdKSg+9FMQ3vTSKfSEUhobQaWjFAxtGKXFFADcUUpoxUgJSU7FJigBKUUYpcUAApRSUoqgHing0xelPA4qkSOpabmlFWpANNApzCkxUsAoopQKAGn0pVT1p4XJ5qUJTSM5SsNValVaVVqaNM1aic85iRpmrsMHOaWCLvitGKAsOBW0IHJUqN7EccXGMVbt7UkjIqW3gwwzWhGNpxXZTprqczdtyOC2x1FX4YAOakiTJHFWAmDiuuMEc86nQbsKgZ7jNFXIbWa4mjjiRpZZThUQbmY+mPWiqbjHRs5+Zt6HhmKKKK+ZPshMUUtFACUUtFACUtFFABRRRQA9RmnYpqGnCmiRppQOKU0YxTaAYVxTakzmmMMUhoSiiikMSkp1JQAUUtJRYApM0tFCQCUtGKKAHIalHSoRUq9KpCYuKcBQBS4xTEIaSn4o280CuIozT1SlVealVeKpRM3Kw1UqVUpypU0ceatIwlMbHHmrMUdOijNW4YskVrGN2cs5j7eIYya0IlximRQ46Vfhg3YzXZCJyymh9rGXb5VJOM8Cr0cAPJFSafEUkwsixhlKsWGRipkXgV1Ric85re41ExxWjpmn3GoXcVrZwvNcSHCogyTVzw34fv/EGoLaadFvc8u54WMerH0rv7vVtK8BWsmneHyl5rbDZc3rKCIj3Vf8Og75PFZ1q/I/Z01eT6fqzOEPaLnk7R79/Jd2XrOHSPhtp6TXKpe+JJUDCPP+qB9+w9+p+lFeV3t5JNNJPcyPJK5y7u2WY+5orBYCnP3q/vSN1jakFy0fdj2/z8zwCin7afJGqRRssiszAkqAcrz3ryD6chxiil5NJSAKKKKACiiigAooooActOFR05eOtAD80tIuOtOFUhNCYpCKfimkUMRGVOaQjFSEU0jNSUMop+0U1higBKKKKACiiigAooooAcFNPA4oUU6mSxy/dp9RrUqrmtIibEA5p6rTlSpVSqsZylYaiVKq5pypmpo48VSic8piRx+tWY09KWNKsxx4rWMTkqVRYYs1dt4aZCuO1X4BXVTgcU6hNBEMVdijAqGFavQxFhnsOOtdcYnLOrYfGgrrPB3hG78RTs4YW9hD8091JwqjuB6nH/ANervgvwX/aEI1TW5DZ6LGRl24ac9lT69M/gOaPHHjAXtqmk6PGtno8IAW3jI+b3Yjqe+Onrk9OedeU5eyo79X0X/BHCmlH2tfbour/yXmXvEfi6y0vT20HwcrQ2QBWe8/5aTnvg+nv+WB188a52tnGceveoWkz1J/Cq0knGM8VtSoxoq0d3u+rHzSrSUpbLZdETSXLM+WOeMc80VmzXATOcH6UVXMup0KEUeZsvpTMVOxyKj6KwwDnofSvnbH05GeKYxzT8UUgGEYFA60+igBh4pKkooAbtoxSkZFIFOaAExzTiM0tFAAvFOzTRTqYD6Sm5p4phYaRTSOalxmmlaGgI6QjNPxikpAMK4ptS4pMUgI6KdtoC80ANp6rTgKdigTYgpTS0oGaaJuC1YUVGq1YjU5rSJlKQ5F4qZUoRasItbRRzzmIiVPGlORKsxpWsYnHUqCRx1ZSOnRpVy3iD5AVicZGO2OTn8M1vGBw1KhGicVahQ0Rpir9rCXdVVSzE4AAySa6IxOKdaw+2j9a9Q8JeDraysV13xb+5slG+G0bhp+OCeeB0479+Or9E0DTfBlhDrXi1Q9+/zWenYyc/3nH+QPrwOQ8WeKr7xHfNNduRFn5IlPyqO3+f/r1hKpPEPko6R6v/AC/zNYwjQtUrq8ukf1f+RqeNvGdzrk3k237iwjG2ONOABjHA+mRnqR6DiuKkb1pryE9OKqTTkZA5963pwjRjywIcp1pc9R3ZJNMiq2ScjoKy7i5J6cCmzzH1qnJJUTqHTFN7BJIfWiqsklFYcxuqWhzSjHWlwPSlpCeK80+lIGGDTakamYqWAlFLiikA3FLRRQAYpMUtFACUtFFABRRRQAopaQUopgSCjGaaKkXpTAjYU3FTMuaYy0WAjoxS4opANxTlWjFOFITExS0tLjHSmiRAtPVOlOVeamRatIzlKwirViNM/lQiZqzCnDfStYxOaUxI0qzHHmliTNX7O0e4l8uPYDtZsswUYAJPJ9hW0UcdSoRRx1ZSP2pY09qsItdEYnBUqCIlWYVwelESVqaVY3N/dR2lnA008rYREXLE1ulZXOKdR7EdjZvczRxQI8k0jbVRFySfavWLGw074b2C3uqrFeeJpUJt7YEMttkcM3v7/gO5p3k2Xwy0oyDyLzxTMu0NnKWoIHAHc/54BGfLNS1Ce+vJbm8mee4lbc8jnJY1z3eK0WkPz/4Bq7YTV61O3SP/AAfyLuuard6zqEt7fzNLcSnJY9B6ADsPas4jHU1D5uKhkuK6bqK5Y7GEYuT5patkk0gVTyKy7iYnp0qWaQN3qhcOAuB1zWMpnZCkRyPiqkklE0lVneueUjvp0gkb3oqs75orFvU6VTKFMxlqfTSCOa5j1xrLTMU/mkxSENpCKdSUgG4oxS4oNACYoxS4ooAbTsDaDnnPIxRRQAmKKWigAoFFHSgBwp6mmCnLTQElIeaAc0tMCNlwabipqMUWAhApcU8DNOAosSxmMCnqM0oXNSolNIiUgRKnRaEX1qxFHzWyRyzmLGlW4U+VqZGlXoo/3RP+1W0UcVSoNij59qtRpRHHVhF9K6IxOGpUEVatwwZ57Y61JaW29d8h2xjqfX2rU0nTrnVr6Cy0+BpZpTtRF/mf8a3ikldnDOfRbkWk6Zc6lfQ2dhC01xK21EXqa9Q+1aV8OLR7O1eO68SSJ/pFwgBFt0/dpkHn3/EjotJqV1ZfDbSn07S5I7nxPcJi5uRyLYEfdX35/qewryi5uHmkd5XZ3YlmZjkknqSa57PE6vSH5/8AA/M1v9V0WtT/ANJ/4P5FrVtTn1C7ee5cs7Enr05z/Mn+fWsxnG6o5HA4zUDyV0NpKy2MIwbd3uSyy8cVTkkJPXFJJLxiqsknFYykd1OkSNLg9apTy0kklVpH4rCUjup0wdu5qs7USPULNisJSOyEAY+9FQs2TRWfMb8ncZ0opWpKyOsa1GBS0YpANIpNtPIp2OKYEePWmEVITTcUAMxRinYopANxRinUlACYoxS0UAJRilooAKUUlFAEopRTF607OKaYDqU0CiqASlApwFOVaErkNiolTKvNIq1Oi1okc05Do0qzEnpTI1q5GnpW0YnFUmLGnatBU/0df96oI0xV7Z+4i/E10RiefUmRqlaVrB5o82UBIVABIGN2B0HvT9I0/wC1O0kx2W0XLt6+wrp9J0WTW7mNjG0NinyxIBy49v8AGtk0tWcbvLRbmXpOl3mt3iQWcJIzgf3VHua9KuLqz+HWiva6SUuPEN0mJbkjPlL7Dt7Dv1PYVu29rb+H9Pe2sEQXqoN7Ku5YM8KpH8Tk9F6/livL/EV951xNBbMCx/19wX34B5IDdyT1PfoPlHPN7RYmXL9lfj6nR7J4Vc1/ffXt6eZzNzNLdTu8jtJI7FndzkknqSaoTygfKhz6n1qe7nXb5UGfLHVj1as9j612ykckKYjHjk1XkfJpZHqrI9YSmdtOmEslVpJM0SPVZ261zykd1OmDtzVd2pXNQynacZB9xWMmdsIW2Gs2KhY0Mc03NZN3OiMBmfmopG60VJryktFKKXFQapDcUYp2KMUD5RoFOI4oxTjyKYuUgZeaMU5gc0mKRVhKTFOxRQFhuM0mKfiii4uVDMUYp9FAcqGYoxTsUEUByoZijaadg0ooDlGgYpQeadSYoE4jgacKZUiVSJHgYqSMcU0CpVHFXEylsPjFTxrTEFWIxWsTkqMkjWrkIqCEVbjFbxR51Vk0a5rZsbGS8mt4IhkkZJ9Bnk1lwjmvoL4U+B0WxGpanCTuQFIz/F3APt6//WrSrWjRhzyOSnSliKns4nGWegHy4EdCLVOVj7yn1PtXoGlafPaSRWtmitqkg49Lcep9/wCX1rqDpeLpfJgX7Y3MeQAIV/vnjr6D9B0HO+LNds/DOn3MNjOzXEhInuz94n+6tee8TKv7sV/X9fed0cLHDpzm/wCvLz/I5zx9qttpMDaTpdwWdebm73dHOQ2PVj0z2HA6nPkV/eeaPKh+SEH8W9zT9Y1KS+mZm+WPPC5/U+9ZTPmvTpUlSjbqeZVqOtK+y6CO1VpXp0j81VleiUjWnTGyvVaR6dI9VpHrnlI9CnTEkeq7tSu1QMeaxcjthAR2qBmzTpDUdZSZ0RgBqMmnUhGRUGqQ2ilIopXKJwTjGeOuKWminZpGoYpKcBkUuKAG0U7bRigBhFIw4qQimMOaAI6KcRSYpAFJilxRipuAmKSnYoxTuA2iloouAlFLRTuAlFLRRcApy0mKcgqrkSJQamj7VCtSx9quO5hMspU6CoE61YSt4nHURZh6ircdU4+tWoz0reLPPqo7D4e6Smr+IreGYZhQ72H97ngficV9c2apa2ESvhAqjP1r5J+HusR6XqwMwG1yp56HHavRPEXxSjZ3RXluNp+WMYVQfr/+uuXGUZ1pJR2NMDiKeGjKUt2d7428TQWFnceU22E53EH5pT6fT/P1+c/EWsTatetNMw2jhFHRRR4i8S3utz7rpwsY+7GvRf8AGsJ39TXXhqEaEfM4sVXnip3ew5n9ahkf0pHaq8klaykTTpiSPg1WkeiR6ru+K55SO+lSCRu9RXGFkKq6uB/EucH86a7VDIaxcjuhAa5qJjzTicio2rJyOmMbDWqM09qaahmqQ2ilxSEUirCUUYopBZk+MDmgc0rD0oUYNSWGMU4HNGKMVVxhRRRRcAopaUigCNhTcVJimsOaTAjIopxGKKgBKSnUUANxRinUUANxRS0YoAbS0uKMUAJQKdRiqiTJD04NTxnmoKkU4rRMxki0h5qZDVVDVhDW0Wcs4lpDViNsVUjb3qZTxxW8Wcc4Gnp75uo/Y5pbiXM7/wC8ah0s/wCkj2UmoHk+dvrWimc8qWhOXprPUG+mGShzJVIkd6gkems9Qu1ZSkdEKVhZG61XZqVmyaic1lKR2QgNYjNRMaGPNNJrJs6YxEJpuc0oOTRgVNzZIYaZUrCmEUi0htIaXFGKQxtFLiigC1ijFLijFTcoQCloooAMUmKdRSuAgFKMd6KKLgIwweKTHFPxQRTAiK5pCvtipcUmKQiIqaTBqXFFOwWIgDSVNikPNFgsRUVJto2ilYCOipNoo2gdKLAMA5p+KXFFNAxMU4UAUYqkzNolU4qZWquKepwKtMxlEtq1SK+KqK2OlSq2a1UjCVM2NKPzSH0WqO/NWdObbbzt7f0rP3VSnqZypaE2+mF6j3U1mxQ5CVMeWqJjTWfNRs1ZuRrGmDNUbNQxphqHI3jFIQ8000tFSapCY70tFIRmlc0sJ1pCKdijFAyM0mKewpuKAExRT9tFArlqmkU6jFZ2KExxSYp1GKLANA5p1GKKdgG4p1FIaLALSikpRTQCMuKYRUvWkK+tKwEdFOxRgUAMNJUm0Gk20XAbRinYoxRcBuKMU7BpMUXATFGM07FApXAbRTyKbii4rC0oNIKWrUiHEkBpQaZkYozVXM3E1rRtumyn1z/Ks/dV3OzRz78/rWbk9qakEobEu6msc0zcaM0NiUAJphNKx4phPFK5SiBNNpaKlstRG0U7FJii5SQmKMUtGKQxKTFOxS44ouFhlIRT8UmKAsMIwKKcy8UUCsWKOopaKzuaiYopaMUXASjFLRTTCwYpMUtFPmFYQiiloo5gsFOxmm0tO6CwhWkIp+aQ80MLDBRTiMUmKm4WEopaKLhYSlxRRTuhWEIoxilzSMM0rhYMUUmKUUXCwmKMU/IpKrQVhtKDxS0YoFY07obdLQeyisytTVPltY19x/KsvAoiyprUSjOOlLikp3JsJmm0+koCw3FFPppHpUgN60U7FIadxiUUoFLjBouA2inAZoxii4DcUU8dKTHpRcBp6UU4rxRSES0YqTbRioNbMjxRin0uKLj5SPFGKkIx70UCsR4NLipBSEUwsR4pcU7b7U4D2oCxFijFSlQelN20BYbRTttG2gLDTzSYqQLSlc0CIsUmKl28Um0+lAEdFPK0mKAG0YpcUUAJikxTqKAG4opaMUANp8KlpkX1YCkxU9iu67iHvmgLFrWD8sQ+prNB9RWhrP8ArUA9M1n0J6DktRCSaTBp9GKLisMwaMGn4oouFhmDRzT8UhFFwsN5pB1p5FGKLisNop2KMUXCw2g9KXApcU7hYaOlLmjFGKLhyidqKOgop3RNi5jNJtp+KKyOgjxSkU7FGKAGYoxT6KAGgUYp2KKAEpKdijFMVhoGKXGaXFGKLsY3bRtp1GKLgNpaXFFF2KwUuKSlquYVhpFN21LQRmi6AgxzQVqXZSbaVwsQ4oK1Lto20XDlIgKMVJtFIV9KLhYj21b0xM3S+wJqDaavaSn75yey0m9BpakWrc3K/wC7VLGKu6lzdt7ACquKEwkrsjxRipcCkxTuTykeKKkIpMUByjMUlPxRigVhlFPxRtphYZRTttG00BYbijFLg0YNAhMUYpaKAGkUUuKKpJWEXsUmKl24ppFY3NxmKMU7FGKLgNxSYp+KTFFwG4oxTsUUXAbilxxS4pcUXCwzbRin0YpgR4oqTFHQEYHPei4hmKKdRigYylFOpcUCsNFOAzSCnKcUAkNNNxU2AaTYKAsQ4oxUuygpQFiHbRin4pMUANxWlpC/LKfoKz8VraSmLdj6t/ShjjuZl7zdSfXFQbanm5mc/wC0ajxQIZijHrT8UYoAZgUhHpT8UYoAZg0YNPxRimBFil2ipMUYouIZtFIRjpT8UYouBFjNFS4FG0U7gR4pMVLikxRcViIrRUhWimJo0SnFMKYqUHt2pcZrI2sV8UYqVl9KZigLDMUm2pMe1Jj2oCw0rRinYpKAsJijFLS0CsJtFG2nUYoCxGRSgdadRQFhmKCKfikxQFiPFLin4oxQFhmKMU8ijHNAWBeKdik205VPpTuITFIRT3PllAVY7+AeAB9SeBUrRsnE0ckRzj51wPz6Gpc0nZlcrKhUk80jDFXGhNRNHjtVcwrFetrTl22Se+TWUy+1bca+Xp4PpHn9KTZUNzn2OWJ96binlaTFO5A2jFPxSYouAmKTGafinhc07gQ7RRsz0qcJTtlAFcrSbatbKYyUAV8UYqYpTdpFArDDz1/lSYp5U0bKAI8UYqTZQEzQFmRYop5XFFMlov7RS7ak20mKxudFhuKaUFSYpMUwsQFTSYqfFIVpWFYhxRipdopNoNGoWIsUYqTbTgvFGoWI8e1G2nkYNOxTFYhK0mKmK5pNnvS1HYixRipdlJtp3YrEWKMGpNpJpduKLsLEWM0HCKS2AuMkntUoQ02UurJDboJbqU4jQnA9yfQChysrsLEthaS3vzQ7VhxnzG5z9B3/AEqpdavodiCJLie+m6bYvlA/LH8zVfWNQj8Nh4LcrcavIP3lww/1YI7Dt7D8TXDuzO7O7FnY7mZjkk+tcblKo730KlJQ0tqdLfeKYpF22ek20f8AtzfvD/T+tVY/FerKxLzpKrcGOSJSpHp06VhUVXJEz9pK9zsNL8QpP/x9zW9kucbdkj/iBg8e2a1m1GxK5jv7Wf1w3ln8m4/WvOaktZRb3EcrRRzBTnZIMqfrTvJbMan3R6RhWYBc5YblBBGR6jPbmtm9Ty7GT2XFYHha8try2j8pEj2lUcKOUJPAPsexHH0rqtYjxZvx6fzrSM29zaMdLo5Qjmm7anePmmYrcxsR7aTbUhFJigLDNtSLSYoxQKxYVRTtgzUSMamRvWmmMXy/amyBmVVJ+Veg9KsLyKXaKdx2KLR0wpV5kFQstAmittpuKnxTGH1pXFYjxSBcdKkxSGi4WIitFPPSincRo7qaRUm32oIrA6SMdOaCM1Jj2pduOlAWISKaRU+KQr7UXFYgxRgg1NspClF2HKQnrRUuykK07sXKMxQBTwKMUrhYZtoxT8UBfWncLEeKMVIFpdhouFiLFGKk2U9Y6LhYrSSLCuX6ngDOCTSXOo22kaPcahDJFPfMRCGHKhuu0HuAOT6n9LUsUaIZ5I1YxKWBIyR9K5rx/CtvaaXEXPnYdnQH5ckgsfxJP5VhWfM1EPhTZyMkjzSNJKxeRjuZickmm0igjrS0zmCiiigAooooA0/DeoS6brFvPDhgDh4z0de6mvWri6hudPhe3bdbTHMRPVCBzGfcdvb6ZPjmmDN4uewJrprG4vII/wDRQ8sDyBZYl6g9VYe4wT+BzxWbupXR0UpWi0zppY8Gq7JV23kF1axzKPvrkj0PcfnUEi89K6YyG0ivtpNntVhUJ7UilCxVWDsvBVPmI/AVTkTylfyzShPUVZCtjJt7r/wHf/ChZIfMCGRBIf4GOG/I81Kmh8pCqYpwXFWDHR5VWpC5RqEVMMGo9mO1OHFVcBSBUMi1YXBFMdeKA5SoUPak2GrKqaGAoFYqbaaVzVhsVHikKzIWXiipce1FFwsX9tG2pdtJisbnRYj2ijbUuKSi4WI9hpNtTUYouKxDsPoaaVNWKSi47EG2jbmpWFIM07isRiOgpUgJFOouFiDZ7UeWamNJjPrRcLERXapJ4FRme3SfyZpRHJkDbJlTz9ai16Y2ukTSo22RSpU++4VWjtLHxfpMbB1h1eBAjMeS2B39QfXtWc6nK/IXktzZ8rFKqYrg1utW8P3Yt7jfHgcRSfMjD/Z/+tXW6JrdtquI/wDU3OOYic5/3T3/AJ1SkmroUZJuzH6yZltFW2U+czjacZAI6frgfU1wniy48zV/s6tvS0jW3Df3iv3iffcTXe6tem0mt40QyzcyLEP4yOFB9Bkg5/2fevNtcl8/Wr2Tai5lYYjGFOOMj69azesiauisUqKKMFiAvJPAHrVHOPhjknbbDG7t1wozTZ0kgk2SoyP/AHWGDXWW9nDaWzQwEfaSmT83JOOtc/rU4udSkdfur8g98VCldm06PJG73KQ96KKKsxL2kjM0h9gK6DQrs22qEZwDFv8A++WBP/job86wtIHyyN6kCtvS7dpbozbVMUYKSsTyFdSv5ZYZ/wDrVnI2hsegTJmsTUL6G2VmkcRoAR5hGdzD+FR1Y+vQDuc8Vd1K+WDTmml3BEjDSFTgknogPqT+Q59K84vryW9uDLORnoqqMKg7ADsBQpvZG0mi5qerG5mieEOPLyR5wVgc/wCzjH8z71FPqF49rEiXUwtgNoiDkKvtx1/GqFSW53GSHu4yv1HT/PtSfdihvbuMyfWr1vq17BH5QmMkHeKYCRD+B/pVCiixN2dfo+uLPL5e0o5HELPkMf8AYY8g/wCyxI9x0rpYSk8e+NsgEqR0KkdQR2PtXlddT4f1cl/Mnf8AeRKBN/01j/vH/aTjnuufSrjNrRjTOrZKjZc1fZAV4qBkxW6dxuJU2kU7GalIxUbcUxEeOaawqXr0prDmi4NFZlwabirJWmkYpiItvtRUh6UU0Sy/tpNtTbaNtc9zq5SDijA7VNtoC0XCxDilABqXb60baLhYi2CkKmpdtIUp3FYhK0mKnK8Ypu0ii4WIduKMVJikxRcVhoFO2gUoFOt4Ptr7cf6Kpw5x/rD/AHR7ev5euFKairsLHMeM3xpcDHGJ5MRj1QDJb8Ttx7fWuNVijAqSpHQg4rqfiDqMV5qcMFuwdbZSGYHI3HqPwwK5SoheSuznn8Whux+JLt7X7NfpFewdvOXLr9G/xzVeRtMl2vb/AGuymByDkSoD+hH15+lZVLmnypbC5m9zppPEV3Db5uFjlCIQLqEbjIwHyBu4wSW5APArmrXTri5j80jbEf4upP0Hc0lPt5pbWQvbvtJ6jsfqKEmK6b97Yt2egyM266bYnUIGyx+p6VetdNW12kKrTu244PyqAc4H44+tWNP1CK7G04jm7oT1+nrUq/PNk55OQCP4R/8AXOaycpX1OyFKnZOJBqExsrGeQkea2duB3I/oB+lcfuwPeuu1xGmjjhhXdNKdoPZV7k/pS2Ok29uih1Ekmcsx6E/4VUZJK5NWlKpPljsjE0/T1OyW/JjiYZVOcsPU+g96j1aCG3VMNunkYsccKF7YHpz+ldhHb3U9wv2fy0gX/WSEEsfRR+vqT2Fc1r9k0c7xQwOgtog8xcjKbjkKew+8AB1559mndmVWnGnHlI9LGLXnuxNd54Utvsui3VzNEH+0thYyPv8A8IH4k4pfC/gc3fhdZrxmgvJhvhBB+Qc/eHv+nHuK2r1hZTWVvCB5cUirhv7oIQfqwP4Um9yqdNxSbOT8ez/Z47XTVOWI+0TN/fY5H+P4Y9K46ug8d+ZN4pnROSqqFHttyf61zoJLEdsZzU0/h1FN6jqWM7Jo3P8ACf06GmdGX3pWGRiqJT6ofKuyaRfRuP502pJjlkbuyA1HQipq0nYKsWFy1neRToAxQ8qejDoQfYjIqvRQSes6HIJdPC8t5J8sMf4lwCh/75K/jVmRe4rD8C3RuLDy242IE+pUnP8A46yD8K6KRRWkGbpXRnyCoHWrkgxk1WY5NaktEHSinsKZigliGkIp2KcMUxEJFFSFfaihMLGptPpRtqwEpNlc3MdJCFpdgNS7KNmKfMFiAx0hSrOKNtHMOxV2Uu2rBWm7aOYViDZ7UhQ1YZOKjKkUcwWINtIFqcrmjb7U+YnlK3ledcxQbigYF3I6lRjIB7Z3Dn0zXO+LfEyJG2naSwVANjyp0A6bV/xrqWjAuoeSDIrxA+mRn/2WvJL22ksrua3mGHiYqffFZtc09TKpJxjZEFGaM0VqcwZoooRZJG2xRlz6Lk/0ouAGjNWBYXpGRbH/AL7A/nQ9lcxrueBwPbDfyouh8suxWZc4IJDKcqw6g1taVf8An3CrNxcGMqfRsHqPzP5VjAg9KdEzRzRvGMyKwKj1PpSlG6KpzcHdHWswQbm4A707PNWdF0+fVozugkh/hbzEO33+boR9OefrjpLTw3b24HnTPNj0G3P8z+RFYWPRU1uh2g26Rx5ZCJYcLgnoWRWJx64YD6AVJJp9kEZPs6bWm89gcnc+c5Pr+NXNqRKRGqqCSTtGMn1qvu3SKPU4qlcyavudFGdsKD0UVxGtMZ7qOFXKSXG5UYdiCr/+yGuykbbE59FJrm/KR2jZgCUO5T6HBH8iaaRdRXVjkfEtvJLrVtqcceI5Nqt9SgwfxBx/wE1zc9n++fyGBRicHYQocH7uenqOtehNAbiSeCOMuIXIf5sFlbDADtkbmx6YxxuzXKpC4u5c/wDHvNDzt4w3H9P60o6aM57c2hzDZ3KcEYPPt2/rTq1tWtAnnXCcKygMPQ7l5rJqzOUXF2Zb+ytJapLvRWEY2xscFh7f0qopyMiuhszHDp+2Xb5aou8nnJx0P+fSufJBYkLtBJOPT2pIqa2YUUmaeis7qqDLMcAepoIO5+HgzGP+2/8A7QrrZQcmuX+HsZFuWBzt805HcMUA/wDRZrqLjvTizop/CVXqqwwxqds1EetapiZFRin7aMU7k2GbaAtSAU7Zmi4WIsUVLtx1ophY2dtJipMUmK5jq5SMrRtqTFJigOQj2+tLtp+KMUC5WR7aTb9KlxSYoDlZFtpNlTY9qTHtQFmRbKNlS49qUCgVmUZl3ahZJyGQvN7EBduPzcH8K4z4gaRML7+0IImeGRR5pUZ2sOMn2xiuz1J3S4j+zyRpLFFJNIXGQIhj9S20D8euMVzf/CQaoy/MtirdmCM2P/HhUNtSujOUeZOJ592z29av22lzzAM+IkP94c/lXRTl7qVJbpxI6fdAUKq/QD+uaQmrc2TDDdZFGDTLaI5KmQ/7ZyPy6VcVQowoAHoBS0VDbZ0xhGOyClpBz0rJ1DVMZitTyOC/+FCTewpzUFdl27soLkfOmH/vrwag0uwWK4K4MlwCAOOOemBWJHLJHL5iOwfu2ev19a7XwVF/a2pxuWEflxkyY4JIIA2+nXOe3bnkW7pHNGcKkr21Ox0WCS1t2RyNoAU+7jIY/QfKv/ATVt271YkRY41SNQqqMAAYAFUpKlHRayI5Gptqpa6i4/iBoK1Z0uPdeKfQE1a2JS1NC+4tJf8AdNc+K6LUvls3/AfrWDszQip7jZiYrS4eAASlCw46tj/6wrjJUMUrRsApU7cDoMV3SLXL63ZMjTmHavlMoXOTlducY9sHHsMelJkp2Zzusf8AIPk+q/8AoQrAVDKyovVjtH41s6y5/s9A2AzsAQO3f+lUdGj829Qj7qDef6f59qFsY1femkTaunkQoGO1d3yoHLZ65P8AL86za19bVVXe5zIxCp/sr1J+vas+0sZ7m7ihRcFxu5B4Gep/w6nj1FNaoiqrTsiCtbTbC5WyudQRNqwxllZhwM/Ln684Hvz2rS03wnc6jdMkREVshx5jEE8HBJwevUgZ9O3Ndl4g0vboP9kaajGa5ZFLt0VVIJZj2AAAA9wBRdAoNpsi8FW6w6ShA+bYqH36v/7UI/CtacZNPsrdLKzit4ySIxgk9z3P4nJocZpHQo8qsUpFqIj2q46VCyelaJg0VytNK1PsNJtPpTuLlIQtPp+2lC5pi5SOipfLOelFFxWNrbRtqwVFJtrmudXKQ7Pak21NjFHFAWIGTik2VYxRtoCxXC0FKnxQBRcLFbZSFDVor7UYp3YirsNOVNuSeKn21meIFkntotPgcpNfSCDcvVU6u34KD+lFxSdlcwtWu86SJCNs2pOJcdxbrkRg/U5b8TWBWjr12L7VJXjAEK/u4gOgVeB/j+NZ/QYqV3HFWVhtJRS0xiUyRiMKv3m4Ht71JisrVrww7kjP7xhtXB+6vc/nx+FCVyKkuVXINUvuttbkhF4du59v8ay6AMUVulZHmzk5u7Cuz+FZzrkydSY934DIP8xXGV6H8I7f/SrucryYzGG+hUkfqKmfwl0U/aI7+ccVRYcmtSZKqSIOuKxiz0XEp7avaNHuuHPotV9hrU0WPCyMfYVbegox1GawuLYA92rG2gVt60pxEPcmsnYaSY5LUauBWXqkJlvEhB2/bFVN2M7TGxccfQt+Va+w1HdlYbd7l4w5t1aVfYhT/TI/GmZyjdHE63oAe7kXeGtrKF7i4dVKjplYxkn5sA/gfpU3hfR9Pgt7eC/uY4ZLy1M/mSHZsYMuwKTjI2s2ceh9Kl1rVntJBZyPJPEVUygPgs6t1yQcAsp+UDGMetUrDWr06nPPDczoLgkvJuwzsMdcccc9MD24pX5lZGapvmUyudFnurtpktbm6WPhPLhZlA9eB3/wqzpNtJp149xdW032luFL4TB4GMEggbdwz6mk1DXHyy3F1PO/dN5bH1ycVkSatOw/drGn1y3+FNJscuVPU9U0x3QzWTWS2iWoRVCOGU5Gcce2PXrU8h5Nch4U1m8vpo0lyXXZEZAo2MuTgN3BA3YOfb0rsp4yKm1nqaU3eJUJqMipWGKaasbVyFhzTCtTYoxQSQbaCtTYpcUAV9lKExU+KNtO7CxFgUVLtFFNMTRsbaXbVgx00pXJzHXYg2ikKelT7aTFPmCxBsNJsIqxil20cwrFbaaTb71Z2+gpNtPmCxX20m2rG2k2ijmCxEqHNch4i1T7DqF1eFG8i2h+ypKDykz8kgdSNpxx3H5dq5WONnchUUFmJ7AV5P47uj9j0+3AKmbddyKeoZzn+Zari7uxz4h8sSGCaOaPfC6uvqpzTs561x+35sjg+o4NTx3l1H924k/4Fhv51rydjCOK/mR1NFc6NUux/Gh+qUv9q3frH/3x/wDXqeVl/WYG/I4jjd2+6oLH8K5JmZ2Z3+8x3Grkup3LwyI/lkMpU/L6j61S+tXBWOevVU2kgpaMUtUzATFevfC+28vTz8uNsYZj6s5J/wDQRH+deT2kDXN1FCnBkYLn0z3r6E8O2S2miwqI9jSDzCMYIyBtB9woVfwrGq7Kx14SDcrkkq1WZKvyLUDJmsoy0PQaKhjrX0uIC1z6sTVDZW3p8W20TPfmm5aDhHUydYH76MegJrOKe1amqDddkf3QBVTaaaehElqVglVdVKpaFZCoSRhGxY4AU/eJP+7mtLZWVrF0kdrcM3Nvbr5kxIGGI5EY9zxn8u/BcmS0PNdc3vqFzJ8xRnKxuykZAAHQ9+5+tV7iby7K0hgch1G9nHUZB/U5qK4nklz50srSsCQc8A5ySR9WNMsYVmuIoTypPze4HX/D8a0guphOT+HqXLHTBJDvnLLu5VVOOPU1DqFi1ph1JaI8ZPUH3roMUk0azQvG/wB1gQaam7jdGPLZbkHgu+W0up45P9W6rL+Mbbv5Bq9SnXmvF9Khd78QHh2WSI49SpFe0xP9otYZv+eiK/5jNTU0dwodUUZE5qPYauulR7aLm1ioyEdqTafSre2kKCjmEV9ntRtqfb7Uuyi4WK+yl2VNspNvtT5gsRbKKlxRRzEs6DYKPLqXFLiuS53WIPLppjqztzRsouFkU/L9qNlWylJ5eTRcXKitso2j0qwUxRtHtRcOVFVkzTfLq3s9qPLp3DlRi+IkLaPNEOPPKwH/AHXYK36E14742uvtfiK4xykP7lfbHX9c16d4vvhHrml2/mAQQCW5nXucRtt/Lk/iK8cupGnuJZnxukcufqTmt6aPMxUk5WRVNJUhFNIra5yWI6dRjFKKQmhrcqfpQpyoPqKcRTE+4PyqkKw6jNLijFFy7I6XwBZG81oALu4EY9ixwT+CeYfwr32QV5d8FbdJZ7tvlLRDceOSTwMfQb/++xXqki1yVZXlY9PBwtC5SkXJqFkzn61cZM9ajMfpU3N3HUr+XXQQRbYUX0UCseOIl1X1OK6TZxxSbLhE5jUUJvZfTOKrbKvXKlriQ+rGo/Lp3ZLjqULqSO1tpZ5iFjjUuxJ6AV594u8yPQrC1mwgG1nQfeBUdW5HzEkHaeQMk8njY8caiPsrbsvAJvKiiB2h3X7zsRyQCMY45BPPGPPbm4luWDTOWxwB0A+g7VtCN9WcVWprZFRm3ycKy4yMHn9fwq94eizNNKf4QUH4nJ/kKrVp6CoW1mx180k/kK1dktDOD56ibNLFJTqbWZ1lLS02+MLZT0eVWA9iMfzBr1Pw6C/hrS2bqbWLP12CvMLHH/CXad65T+Zr1vR1/wCJLZYAAMKkAfSpqPZmVJe+yGVKhINXpUzUOypUjdxK2KMVYZBTfLqri5SDFJipzHRsouLlIMUYqfZSeWadw5SHFFTGM47UU00JxOg2U3ZzU+2jbXDzHfykO3FLtqUrSbaOYLEeKMVJto2mlzMLIi2UnlVOENKqE0+YOUgEdMupI7W1lnnYJDEhkdvRQMk1dCVheKZWItLGIgee/mTH/pkmCR+LFR9CacXzOxnUahFyPNvGT/6M93OrJdXCMdpOSpkZeD9Ej21wTJxxXVfEC6E/iFoUYlYIURh/tZJ/kwrmT0rup/Dc8SbvLUrEU3FSGmmrMyNhSU5hTaAGscKTQuAApPIHTvVixi829gTtvBP0HP8ASt7WApsJSwBwBjI6HNDlbQuNPmTkc3RSgZpSMCgk9H+E2pR2l3ChIVWaSOb23mPYx/FSPbOa9kkSvm/wXa3N1rsQtjiNATOc8eWeCD9en69q988KX76ha3ME5Zp7OUQtI3/LQFQyt9cNg+4J71yV1Z3R6ODnpysusntTPLq80JPak+zn0NZc6O/lZBZxbruID1zW6y4Un0FVNMt83YJ7AmrGvX1tpOmTXN06oiqcAnG44Jx+h+nWk5XehcVyptnPMu5ifemOBGjO/CqMn6Uuh3S6tpcN7GFCS7sbW3A4YjIOBkcegpPEUbReH9TkXOVtZWH4Iau+tmZbx5kePeNZ2d9OhP8ADbCQj/aY8/yFc1W74t/eeILsL92MiMD02gD+lY+2uyOx5L3Ia2vD8Ye1viAd0bRuT2wdwP8AJayStdH4di8nQr+5f/l4lW3jHqF+Zj+eB+NOWw6a95MRuKYD61KwqLFRY67lCwlDeL7Uj/lnLGp/Dn+teyeH1b/hHdLLdTaxE/8AfArxBcprU5h5kG5lx/e8vI/WvoOK3FvbxQp92NAg/AYqK7tZEYbWcilIvpURX1q66YqEpWSZ1tFYpTdlWSlNKU7i5SuUpNlWNtJtoFykGw0bDU+2jbRdisV2Xiip9vtRTuFje2e1G32qxj2pNvtXFc7LFfbS7M1PtFG2i4WK/l0bas7aNtFxlcLml2mpwtLtouBCFNcNe3kb3Op6u7F4FBii9o48g4+r7znuCK6vxNeGw0aZ4v8Aj4lxBDjr5j8A/hnJ9ga8y8d3CWGkWumW2ERgBtB6IvQfnj8q3oxucGMqWtFHnd1O91e3VxL9+WUsfyFQt0pw6N/vH+dMPTmvQ9DyEurImFNp5ppoAY1RmpG60w807CNDQULXjN2VP1P+TV7Xm22O3++6j9c/0pNAj22zyY5kbH4D/wCvmm+IcmKAD+/n9D/jUfaOpK1FmKBijOeACfpUkcZY5PAFWEQLVHMlc6zwNrFpZyLYyQLB53LXDPnc/oeBgdh/9evWfAlxapqGoWZni8+cpPEN4zJ8u1sDvjYCfqK+fkyGBXgg5BHatFdYvxjfMJcdPNjWT/0IGsalLm2OqjX9m1fofUpgpDBXzdZeJ5YHQzWFiwB5eOLy5B9COhr1jQvHFxLZRZto7pYQokl8wiR0/vbduC2O2eoI4rklRlE9GnjITdtjvoXhs1ee5bagwo4JJJPAAHJPsK8y+L2t/adNdbV3EJPkIpUqznI3nB567F59G9a19LOq6xPPf3FxPZ2GNwd2HAxyY06LwSNx568HPHE69dQwalbaha2VuqQTqUjdAwIB/izySe565Oe1VSilLUVWTqRbWx6b4O0ebS/C+nWV2c3EUX7zjGCSTjj0zjPtTvFsIHhrUh03QMv5jH9a0PDGs2/iDSkvLcbGzsljJyY3HVT/AEPoRTPFsQbQblf7xQH/AL7WsuZ8+vc6GkqVo7WPnrVv3mq3rH+Kdz/48aotHWtqK/6fck95WP6mqbLXpJ6HjuOpnSKVUnBOOgHeutvIfsdjp1j/ABQwB5eP+Wj/ADN/SqfhTTl1HxNZxOAYY28+XPTC8gfiR+lX9Wl+16hc3HOJHLAeg7D8qmT1sXSj1M9qhfjrU7riqeoNssp26HYcfXHFCNnorlfwUn27xVYl13b5g5X1G4ZH5V9AyLmvFPhLZG58ZW7gfLbRPM35bB+rj8q9xkTmsMS/eSKwUfdcmUXWoigq80dRNHWCkdnKUzHTSlWylMK1fMLlK2yjZVjbRtouKxV20u2rG2jBouHKytsoqcrminclo3dlJsqx5dGw1wcx2FfbRszVgJS+XT5hWK2z2o21a8uk2CnzCsQBRS7KnKA05UxS5ijiPFU5n122s1A8q0i+0Of+mj5VPyUPn/eFeN+K78X+t3EiNmND5afQf/Xyfxr0DU9WL6ZqmrOSDcs8sXbC42xf+OhM+5NeRljXp0IWPAxFT2kmxjcdKjf2p7HNR9TiulHMN7U009uKjJ4oEMbrTe9BbJpVBY1aEdBojb7FFHVWYH88/wBavzWEVzt88MQvIAJH8qxdJufsTNvUtG3UDqD61srqtqRyXX6rn+VYyWuh3UpwcbSIZ9HhYf6OzRt6Elh+vNUZNOuousW8eqHP6da6DT2N+zrYw3Fy6LuZYYHYgepwOKstb3EaF57S5gUdTNCyD8yKnna0B0qcndHHY2ttYFW/usMH8qftzXUS28VxHtlUOpqp/Y9uPuvKo9Mg/wAxRzrqRLDy+yYeK0dB1aXSb9JkJdAMPHn7yn/OattpVtHGWkllwPUj/CrNvYwW9mzSorDl23gMaHJNBGhJPsegwa0Ljw3bWFoxKszbn9UDHYv/AHyBmuY1wZt9u0MeTg9+Ks+FZEaO3t0jEThCw3EBecnj8+lVdYt90qIbgc8sHA557dPSsVFRZ3qV6eh1Xwz8Rafp/wBntLmUxM9v5crtGQoZCWRs4xgq7ZJPG0ZrsfFOrwy6XdR2ccl0kbKZZYSpSPDgnJJGSMHIGcd+1eSIrW1wlxCzJMssbKw7EMK6OzupbptTUQxRK2mzs3kpsDMNuCQOM8tUSpx5uYjnnGDgcXqI2310D2lYfqaz2rU1xdusXyjtO/8A6EaoRQSzzJDBGXmkIVVHcn+nvXVHY5WT6HqMmm38jQBXaeF4WXvgjOR7jB/l3zVxWWSMOhyprWvLWzstLg0tVhuJlPm3MuAwaT0B9Bk1jfZEidpIN6k9U3ZDfn0qbpm0IyiNkrH11sWir/fkA/Ln+lbTFXUMv3WGRXPa2+65jiH8K7j+J4/kfzq47iqu0GeifAyxJTV75l+Usluje4BZh/48leoulYfw009LLwTpuxQGnQzsR/FuOQf++dtdIUrz60+abZ34any0kimyVGyVdK0xk4rO5vYosnNMKetXWSo2SncXKVCgppUVaZM0zZTuLlK+2l2VY8uk2U7hYrbTRU+w0U1KwuU6Hy6Tyx6GrAU+lJIVRdzkKB3JriuXchVB6U7YPSqc+rW8edmZT/s9Koya1Kf9XCi/U5rWNGcuhm60V1NkxijyxXPnWbsHpH/3zTT4ilj4eFGPtkVp9WqC+swOgZABkmuS8d609j4bv/spAnkTyI2XkqzkID+G7P4U6fV3ueJWZR/dHSsPxNMn2ezUEMHuMHn0R2/mBW1PDOLvMwrYm8WoHD+Pphb6FDbpwGkVQv8AsgH/AOtXnuciup+I1wftFjFzgIz59ckD+lcgX+XjrXdSXu3PHm/eHk03dUe/0BJ+mKOv3vyFWZtis/pzUffk5P6U7IHSm55qkhMXqasRptHvTI0qZRQykh1PQUijNPJwvAqSj3f9n/SGt9EvtUlXH2yURxkjqkeckfViR/wGvWdmRyM1xnw5VoPBWiInGbVHOO5Iz/Wuwt5nyBIuR6ivJrXlNs9mlHlppI53VfAWg6lvf7ELaZ/+WlsfLOfXaPlJ9yDXJ3Hwlu1kP2PU4ZIyeBNGUI+pGc/kK9khgLAECr8NnnkiiNSa6nPUqxieA+JvhBqP9lQS6Xci8vEJM1ucIrZ6bM9xz9489sdD53eeE7+wuvs92kUcw4dEkWQof7p2kjPtnjvX2alp6LXi3jrSI08c3K28cSDKOyopGCVBYnPGec5HHI77q2p1pbMypctapYb8MYrDRJJ47zTYLzdHjzpAPMC9Co3fLj2+X6ngV2af8I8DILWKwtwIS8kRiWFgmDkspAO3GeoxWDZ2AW2uSQwJQYyuOCMg/jxXKapbPukjaVlgU5I6hcdSB61m5czO6WFim5wZzlvoedRaK1mEtrHN5UUy/vIsZb95vHHCDO3dn+miZLK0eWOCGW4hKmPfJJtZwev3QMZre8VXrXc2yIkWkWFRQMA9skVzU0eBWyk5biVKy1KNy9q0zyR6dBG7HcWMkjEn3y2P0qpPK0nBCKuc7UUIv5DAzVuVKqyLWiZPIo7IrkVCetOuLmGBsSyop9M8/lVGfU4FHyCSQ+y4/nitLNkOSW7JHRVXCjA9K52OE6jrSRLkiaYR8eg4J/IE1butSllRkRBHkY3bsmrfgzyYdV82bACgRR8fxucD9A1XsrnLUkpNRR714NCnwppYUYCQLHgdtvy/0rVZcVmeChnwxaexkX8pGH9K2itePN++z2aL9yPoVSuaaY6sslIUGKLm1im0fWoimauMMVGVzTuJoqFKYVq3spjLTUhFfbRtqbb9KNv0p8wrEBWipivHaijmAsXmsAZW1Xcf7zDiseaSa4bMsjN7dqqzXcq/ctz9Sc1Sl1C5H8AX/gJrqp4fl2R5kqre5pFAtNbisObVbgDkj/vmom1bC/vXGfQda6FRl1MvaI2JW9CBVWQKO+ax5NXBPyIx+pxULalO/QIo/Oto0mQ6iNokVkeKmMeiz3UYzJaD7QB6hfvD8VLD8ahN1O3WQ/gMVneIbl/7GuI2Z288C3AB6lyFH86v2empnKSszmfHyR3ekWd7Blgr4BA/hYd/TkCuDVjnFekeJrr+xkWby1lsriXZPAR6g5I/LP1+tcHqlrFb3Ae0kEtnMN8L55x6H3FZUmrWMKm5XozSKe1DDitTJMKFXLUAYFSxChj6kyDinqM01alXgVJoKowKXqwHbOTSE4H9KmiXjJ60mCPpzwA+fB2h7e1nED+CiuysZvnG8bl9cVx3w3jJ8E6PuHP2dfy7fpXcWcHSvLmlzM9m6VNX7HQ2MSSqCnNakcAUVm6bIYUxtBFascu/tiiMO54Ndy5n2HbcVjat4W0zV9RivLyJ2lRdpCuVDgZxnHPGa3BzT1GK6qdFSZzxqSg7xdmZeoaDZ3tmtuyGPYgRHQ/MoHQZPUfWuTl+G9pOz/aL6cqxOQiKpx+Oa9CpjLWtegmk0jWli61NcsZaHz3rmjS219c6W6yvOrFE2qWdx/CwA65GDx/SueeEyQlmQqQxR8gjDDqOa+jPEkxt9PZYiVuJ/wBzGyj5lz1I+gyfrivBvGSRT33kwxqsFsvkouPSuRXUrM9vC4qVeN2tjjb26ghZlUmVh2Tn9elYF5dzzKQcRL6Iefz/AMMVu3sGM8ViXUeK3ikOo5NmUyKo+UAfQVWkGKuSDFVZea3icrVik/WptLYpqVnydonRiP8AgQqNxzmmxv5cyOOqsG/Kn0M76n034IX/AIpq295Jj/5Fetsr6isbwJz4Ytj/ANNJv/Rr1vEZrxanxs9ilL3EQFB2ppT2qfbTCDWZtzFdkqBkwaulc1Gy07lqVyoRUbLzVwrUbR80XAq7aMVY2UbKLgViKKsbcdaKqIjmJJ43QNGwJP51Vcluprnb2GWOLzInddvJ+btVK11Wdm2pO0ntnJr3IWaPFczqJuEOOuKoPDG/3kU/UVUk1CWKEPNIFU/3xjNZzeIAHwFBHqAa0iiXJM1zawH/AJZLQLKA/wAGPoTWbDraScbVJ+uKsHV4Yx+8Ur+Oa01FeJb/ALOjPRnH41nappnnX1hAr5RXM75HZRgD/vpgfwqZfEFmOD5n121DfataXMS4ysoIVJASGTJAODWdRtxaQ2otXOd+IunP/ZtqokHzTZ6Y6Kf8a89OmzKPkZT3xniu98Xaon9paba3kyywqdzOBgsCQOR6gDqPXpXOOVSWSMOrFGKkg+lYU9InPVjGUjC+yXAPMR/A5oMEwHMbflW8Dmjitbmfs0c+EcdUYfUVMgx1rfhHNTFEbqoP1FJspQOeWpMccVt/Zoif9Wn/AHzS/YoSfuKPw/8Ar1Ny+QxVXBrovB2gXHiLWrewt1byywM8gHESdyf6epqGPSoZZAMkEnGS2AK+n/DHhW00LS7ezsV2qiAM4UAyt3Y+pNRUnZaGlKlzP3ti/ptpFaWsNvboEhiQRxqOiqBgCugsY/lFQ2enMx6n8q27XTpFUciuFRl2N8RXgla5LZxVpImBUcEBQc/pVkDFdFKi29UeNUnzPQQYp4pMUtd0VYxCgiikqwOY8TOy3jsV+WC2LofUknP/AKAv5143qlvgsTye5r23xYI1ht5HySXMZUc71Kkkfpn8K8q1iFVkkWM70BO1vUdq8quuWofRZU1Km0ee6lBjNc5eR12mpR9a5e+j5bFXBnRVjY5q4Tk1RlFat0uGIrPnTvXQmcUyjIKrNV11qpJ1qzFn0n8K7tLvwZa7Tlo2ZX9mJ3/ycV1pHpXB/BuwmtNDut5PklkVQe7hcuw/ML/wCvQNteJiLKo0j06MvcVyLHpSYqVlpu2srmtyMio2XNTlaYy0rlJlfFMK1YK0hSlc0UiDFNK1OUpu314p3GmQleKKkIoo5h3Pni8vru5/d3MzMF/h6Cqqkq2VJBHcV6LcWML58y3jYkYyUFcTrVn9kvCoj2I3K85FfRQknokeFKLWrM9iScnk+tJS0CtSAp2c9eabSgUikLSyNtRSf+ekY/NgKSm3P+pT/rtF/wCjFpS2B7HPfEYYuLGRccq4z9CP8ayvFaltQjvkOFu4kkBHY7RkfyrZ+Iqjy7BvQuP/AEGsq/Qy+ENNmPJjmdCfTPT/ANBFYweiZyVF70kY8d1IvU5/HFTreuP45F/HNUgcUoOa1Mrs1odSlHSU/itXF1WTu6H8KxY+amWky4zaNtNVbv5ZqaPVQOWQfg1YHWnYqbI0VRnbeF2Gua3badDmMzMdznoqgZJ/IfnX1Fplzb29tDbxNIEiRY13cnAGBXzL8G4RJ4nlZhnyrVmH13KP6mverO7aLbn5gOxrKaud+G96N2egWV4FAJbArdtNRhCfvJBXF6dOtzGG5Cnsa17e3z0bNZqVjPEUIPc7CGRZFDIwIPcVJXM2krRthWIwelb8MwkXnrXTTqqWjPKq0XTZPRRRW5iFFFJQwKF9Ekt9a+aRhdzAHueP8TXFavptvPcTvsTLux+771v+KLswX1uBgrHDJK4IzkcAV5fea3dRKduw+xFeZiJJzaPay6lO3Onb/h2T6h4dgfOMiuW1TwwuTtP6mrF34pnQHdEP+AsaxLvxcQfmRx+JNRBO56spQtZsy73wu+eHNZF14amA+Rjn6VqXPjFM/Nv/ACBqjJ4wgHXd/wB8f4V0xuckvZ9zEuPD92ucBT9c/wCFM0nQLybVIIjBDMGYbg27gZ5PbpWu3jC0I+bP/fBFb/hTxdZP5tvZrHFdujM08hzgDoAPxqm2kYcsG9z1vwHp0sHhDTEXLt5ZLsSMlyxLZ98k1u/ZJu8dW/Bt5p7eGdPltCxhuYVuRvcMcyDef1Nbgmtm7D9K8ecU5N3M/rU46KOhyzQOOqN+VRNGR1BH4V15Fq3tTTBbn+IfnWfJ5lLHd0ccy4phWuwazt27r+YqGTTICONv5UcjNI46PVHJsvHFRniumfSIz0xUTaOh6fzqeVm6xlM57rRtzW42i+hP51E+juOhb8qOVmixVN9TG2UVqNpcoHB/SilqX7eHc8rU5FV76ygvIttxErjtkcinQsS2M1ZxmvfacWcSfMjitT8Pxqx+ysyf7JGRWLPpl1E2BE7+6qa9MeJW6gZrPntijZUZX+VdNOcZaMwnBrU8++xXX/PvL/3waPsd0P8Al3l/74Nd1sHcUuwelaci3IUjhPslx/zwl/74NQ6hDLHbxl4pFHnw8lSP+Wi16EFX0FZHi5QNDJx/y8W//o5KiUVYbk7Hm3xE/wCPey/3m/kKo6OBd+DdTgPLQP5o9hgH+hq78Qz+4sR/tOf0FUfBI85dUtP+e0GP5j/2aueP8O5zy/i2OapVpDSoa26GBYhNTCq8Z5qwtS0NDhTqbS1NhnqXwSgzPqtxj7qxxg/Ukn+Qr1qNvmArgPgjbAeG72dusl0V/BVX/E138aAGpSuz1KHu00bml3UkI2rgr1wa6vT7hpkXYwQ9x1ribVwjc1t2U43AoxB9qwqQ6nTKCnGx2KxF+eQf7wqSC6ltyBcR8f316GqWl33ASfn0atxoUeErjIYYrH3onk1fcfLNFi3vIZlG1xn0PFWQc1yjRTQN86/KD94dK6OCUGHd6Cu2jW5tGctakoaxehJJKifeZR9TVdrxCcI6E+xrI1a5zNj2rJkm54rOdaTehvSwnMrsi8UXO+51F3/5ZWgjB+u4/wCFeT38+Qa7jxHd7NIvpGbJmlCDPtgY/wDHTXmd7PnPNcivKTbPZoRVOHKZ1/L7965zUJsZrQ1K4wwGawLuXdmumETGrO7KNw2W5qhN91vpVqZs5qhcN8jfSt0ccivMRV/wnJs11B/fRl/TP9KzJW9etP0GQprlofV9v5jH9atr3TJPW59Z/DjnwTpKjjZEYwPTaxX+ldMBXMfDVs+C9Px6y/8Ao166oAYr5uq3zv1PTj8KG5I6Ej6U4zSDo7fnSEUmAetZXHZDvtEw6SNTTdz/AN/9BUVxJHCheV1RB/ExwKxb3xBaQqfJzO/oOB+dWlKWwckexvi+nX+IU9dSm74P41zkeuQPYNcupUqdpjByc9sVzF5qd3dSMWldUJyEU4Aq405yYOFPqj01dVk7j9aeNWPda860PVWs5PLuGZoGPUnOz3reGt6ed2J/ujPKkZ+lKUZxYvZUn0Op/tdP4lx+FFeZ6lr9xP5iRYhiJwD/ABY+tFaRpVGtSfZUjmk35zmrKzuOCBiqEd1zgqPzq2GyK+lnBM5oyLasGGaVxxVVXIqTzsKSa5nBp6Gyldakcir0wKgaH+7mnife+DgLU8abunSq5pRJtF7FLyn9Kx/FqudBkyMYngP/AJGSuuWzB5LH8KxvG9skfhe6YZyHhP8A5FSj2y2JnT91njvxCGYbJvRmH8qyPBM3la+i5wJUZP6/0rW+IB/0eyHfc38hXM6HJ5Ws2T5x+9UH6E4ogr07HFN2qXGatF5Gp3cXZZWA+marLwa1vFsRi1659Hw4/ED+uayM1rHVJmUtJNEyVYQ4WqimrCHik1YEyYU6mKeKcKloo9++EEJi8E2zH/ltLJJ/49t/9lrt48A8gVy3gmE2fhPSYehFujkehYbj+pNdAsx9alQe6PVpyUYpM1YNpb7orRh4ORxWHbynP3q0YXJ/iNTKk2dMakTobWbGK6HT9TCIqS8qOhFcZATx871r2kbHqTj3NYzhZamNenGotTotQmd0V7P5wxAbHUVZtzINPl3KVbPcYqjpwRJUIHOa3GdPJJYgr0qaK1djyaz5EoJHF6lMwuWB7CqE04RGZjgKMmuivzC1w52r+VYXiKSKLRb4njdEyD6sMD9SKHTe56lKouVaHA+L7wppOnxscNLmVh7nB/mxrz+/vAo61s/EDUw2pRxKeIogPoST/TFcHdXRcnmppQurs0rTs7IS8uC8nX/PNZ0zZpZJMt+P9KryyBRzXTFHHKRFO2OKz7l/lapZ5ckms+4kyDWiRhKQyVsmnae+zUrRv7syH9RUDNzTA+2QMOqnIqzK59L+C7mdfDNoiyyKgeXADEAfvXrrYNfuY4QrKkjjozZ/WvI/AtxNNp90sM0iqtw7IqnICtz0+u6ulMuopjYxk/3lArzZ4Tmdz0o1Fyo7OfxFeSJhBFGf7yrk/rWe2qXxz/pUvPvXOibUCf3nkKPxzV+GN2UGU7j/ALPFS8Ioj5yxcXEs2POleTHTexOKg4FOW3BbLu4HsM1WulWNvlfK5xzwaaorZMHMkJHqKbuHqKrscdaryThT8oyatYfzJ9oaGapXV+seVjG5vXtVaS4kcY3ED0FUpSc4zTWHs/eB1B0tw8jZZifb0oquaK6FFW0IuxNxFTwzyKvXgVLfWwglIGQvUVR3eld+6MdjVhulcfNwR29aSeUHknissMR1qYuXTmo5dSubQJJz/DnFXbXUNpQFT1wazdpPakciPGevpTlBNWEpNbHUjUFA4Qn6msTxndtN4avQQAuFb8nB/pVNbyQnGSBUPiKYP4X1MbslYGb8hmsHQjHUt1Lpo8w+IB+Wx/4H/wCy1x4coysvDKciuu8f/esh7P8A+y1x55p0/hOGq/eOk8ZsJriyuVHE0AI/n/WuerW1Sb7Romkt1MYkib8NuP0xWTTgrKxM9ZXHCpEY1GKAaYi2p4qWNTI6ovLMcAfWq0bit3wdbfbfFOlw4yDOrkey/Mf0FSylq7H0PGPKiSNThUUKPwp6lj/EaYWqe2gmnOIULUJ2V2emS2+d3U1t2NvLLjYMj1qraaRMSDK6J7dTXSWEMcMYGS2PwrGpiIr4Wawi+o6ytCjbpGyfQVqxnatVGlRBzxUb6hEBgHcfaue8qjNJI07e7AmwCSQO1ajXBXTkznls1zWmyb5ZWrduXC2MC+ozXRTioo5a0FzLQyLi7zI31rl/HF3t0mOPODNcxKP+Atv/AJKa3mZCxYgcmuN+IsgEOlhOP9JLH8I3H9amUtGjrcUo6HkHi+8MuvXXJ4IH5KKwGfNTa1P5mq3jZ/5asPyOKznmxnNVFWSSOGcvebHyShQTnnNUp5s96hnn+X9aqyS56VaRg5D5pfSqsh+WlJ7mo5GyD9K0SMm7iGmMacTUbHmmkSexfB+XFlPvYANFHjJ9Hk/xFehyXcAH3gfoM15Z8KJcqkPGGgkP5Ov/AMUa9BeFskgisuVN6nbSb5FYnkvYgeIyf0qVdVgC8xuD3xis5oXxniq+CTgDmtPYwkNyaOms5o7mLemRzyD2pLgHH3go965+O3uHP7uNvwqzHpF3L1XH1rGVGnF35rDUm9kVLy1KxszxiVjk7lOa5yR5FY8untkiu6h0O6HDT+WnoATTpdGtooy04MuOSXp+3px0Urj9nN6tHA+fKP8AlrJ/30apXl7dRSjy5mwfXn+ddzLBZr/qLdQfUACsXU7a7LFoYkZcdN+D/Kr5r9CeU5oapeDrJn6qKKW8huGbEkaqR1GaKFYTudhdyG4bL+mMZqr5CkjGRUkcqMPmJz6AVIGQ9A1dKVtCL3IiijtTMY6VYO0jgH86iKkGi4D4toHNUrpD5mRyO1WgMVG0iHIz+VMRROap6wpfR79AT81vIOP901rzRIyblOPY1BJbxvC6Fz8ykfmKTBnmHjwbobKTtlh+eK5Beldh4uPmaHZSf7a/qprj656XwnNVWpaVs6a8ZJ+SVWA+oIP8hVcUgYgEA9etJV2sZ3HilpgpwoAUHFd58G7U3vjJCDgQQSSk/kv/ALNXB1618CIPLOrXpTJISFD+Zb/2Wpltoa0leaPZbewiBBb5z71t2qxW0fzFVH5Vzq3UgGFO36UGfP3zz7mud0pS3Z6SmlsdDNqMMf8AqlaQ/kKoyarcMcJiMf7PWs4SA9DU8du0mCTgU1Rpw1Y1OUtiytw7nLuWPuc1Yjl9arfZ1VeCc+tMUgUe2jtE2jF9To9Im+SQ89RWzqF0Et0zxtj/AKVzmlv/AKPnOMsasa9c4hk5+6uKz9o2W6aumUGve2a5Px1dq/2BfQu36Af1qzNfImcuo+prjvGWoeZPaKrAlY5WOO3KVTV0Z1JpRPKr+9DXMrZ+85P61nyTs2earls9aQtxXQo2R5Uptikkrz6UZpoPy03PAqjO4rGmNS55pjGgLjSflH0qNqXPFMJqkS2ehfDuYxy6cRwPOkjJ9ihP8wK9itVDwqzDmvD/AAfMLeytZXPyrdoSfQb1Br15L6VU2LgAe3NYSi23Y78PJJamuEUHOBUodARtiXP0rAaeV/vOafbuyyAgml7Fs3dVdjo/trBcLGo/Glg1GRH/AHigr7dqyPNY/wARpjSN6n86j6qmL29jZudWl/5ZxAD1JrKubyebIkfC+gGBUGTSZq4YaEdiZV3IYZEH8QpjSIe+alyDUczxxrlgD7Vvyoz52V547eT76Ix/2lzRVG6n3k4AAop2iK7Z0tzZFY9jKVB9OKw2UI7LnODiuo1KVZI2CtgY61y0oIGQpNc+HcpblTSQZHal3etRfP8A3T+VG1yOhrq5SLodK2ENUwMnikutwPNRLIVPrTsIssu5cGhIOck8VF5/HAqWCUtIAx49qLMR5X4mTboMUZ/5ZSBD9Vytcbmu88exfZ4b+L+7dlvwY7//AGauCHJzWUFa5y1XqSwJv8zOchCw/D/62aZWhpKb474ekBb6fMM/oTWfVXu7GfQKcKSlFDQJjq91+Ddmbfwf5zD/AI+bh5B9Bhf5qa8Kr6Y8G2f2bwvpVug2hbZC31Iyf1JqJtRWp04eN5XNfJPyoCT7VJFZPIQZW2j0HJq3EixqMAe5oedV6c1zPEP7J3qmuo6O2iiHyrz6nk0NciIHc2faqF1eMBgH8qzJrgn7x/CojBzd5Gl1HRGlcas38PA9qozarIAcbV9CeayZ7sklUGPc9arZLcsSTXVCgktTKVZ9Dr9N1O7MEQ83AJzwoFV9eu5Zo5fMkZstjk1FYfLDB7AGq2sMdg/2mq1FJ6Ibm+Xcze9ZutaS16sktoVS7Mfl5bo45wD9MnBrRAY9qmjBzzVNJ6GB4ReW09jcvb3cbRTRnDK3aoGJANel/EHTAZBcOgwyhx74O1j+Xl/lXn1xZgRsyOcAE4IzU3V7M55U2tirmmg8VYazmHTYw9mpv2Wb+6Pzp3RHLLsQ5prNVj7JOeyD6tTvsLH70gH0GaLoOR9jPb7xq1Z6fcXfMaYj7yPwo/GtvwroEGpa7a205d4mJaQZx8oBJ6c89Pxr2Kz0XTbIqbazhVl+6xG5h9CcmplUtsaU8PKe55xoHh+4kshZLHLLHK25plXaig4yQTwelemeS3U4q0zBfvHFQvNH65+grNNtnXGmoIYEwOacpK9KiacdgfxNMM59BWiUuom4otecw6mn+YCM5qiJAx5wDUMrZ6GrjfqRJp7Gi06D+IVEbpc+tUKlhgaQ5AwPWqbSV2SlctNcEj5Riqk7ZznlvWrxjVVxWdqEixY5APfmufnc3ZGvLyopynFFZtxdlnO3kdqK25SLnZ/2i0jBFVRHj+IZJqYTHA/dx/lXNrOw+8CKteaCvBoVNdBc3c1ZboA4Kx1A+JBlBg1iMSWNTw3TJw2SKORrUL3JrpDtIcYxWdWi11uXGQRjHIqk2MnFXETGCnx5DCkp6+1NgjhviOF23p/iYRP/ACX/ANlrzcV6L8UG2LEAfmlQBh6BWJ/m36V51WaW5xVvisa3hoq2qCJvuzRvGR68f/WrMYbGKnscVd0Xcl554O1YlZmPpwenvjJ/CqGcsfrS6k392w6lFNpRVEFvTLU32o2tov3p5ViH/AiB/WvqlZIrdAvCqBgAdhXzX4AjEvjHSwedsu//AL5Bb+le9TTbxxWFaPM0juwrsmzQm1Rc4QHFVZL5m6VSG3PJp7MAOOKmNJHXzsdNMQMscVTlnZuBwKWU5PrUTda6YwSRnKTuMpUGTSgZqa2TdMgPdgKu5JvQphFHoMVU1bA8sfU1oouRxWdqi/6QgPOBWa3NpfCUoYpJThBx3NaNvapHy/zN+lNjuAsYGOR2FKLrJ5HFUZGB8QbYy2NtKvZmhb2Drx/48qD8a8lkIZGX1GK9q8TfvtAvCi7jGnnBe5KENj9K8avkEd7MFxt3kr9OorKXxEt9CGN8xofVQaC1QwMDCnsMflTy1Kwk9Bc00tSFqYzAUCudx8M7bF1eX7j5UUQIfUnlv5L+dd287HocVzXgi1Np4dty/Dzkzn/gX3f/AB0LW6KSjd3NIy90cWJ+8SfrSUHpSVslYGwIpjipBQRmgTK9SW8JlbrgCpY7ZpDwQBV23txF0yc9aidVRVluVGLYkNtGnJG4+9Ss2BgAU9hiqlxJhvlrlcnN3ZsklsV9Qkfyjtbb9K56+BdS2Tke/Wty4zIuDWPcRu7Feoz2renZGM2ZdFXvs+OtFbNozN4T6so+W8usf9dmH9ab5+obsyMsh/6aKr/zBrVWD15p32dP7tZc67FcpkM902cx23PXEKD+QqFoZTzsQfSt3yEHalMa46Ue1s9C1A5rYwPNBBB5rZuIUHO2qc0YcccVvGXMjN6FKhSR0NWVtwPvc0TeTb28k0uFjjUsx9AKYrnmnxGkP2qZG2tmOJlOeQMsMfzP41wddZ4qlaWx8242/aJZST7Dk4HsMAfgK5Ss07nFV+I0rdPL0G5nU8vIIj9Mf/XrMHWtTT3DaPqELc8K6j36n+VZeKFuTLZC0oNJSUyTs/hXCsviYyt/yxgZ1+pIX+RNevb685+FumPBbXGoyjb548uL3UHk/n/Ku73k96zkrs7aLcYFkyCk3EjrUG71pynmrirGnMybbnvSGOnx80/HHUVdxpohVcVZsVzdRf71Q8Vc0wZuwfQE0rlLc3F4rH1A7rtvbitbcBwSM1i3RzdSn/aqUaT2GUtR+YvqKje6UDC9aZmTs6j5WxgjBBrx7XIBbXCquSqboc+pQlc/kBXqDuXbLda4fxfa7ZbtgM52Tj2z8rD/AMdz+NRNdSJdzkIRgSdcK55+vNKWp0LfurlcfeVWz6YOP/Zv0qDNIhDy1EUT3M0cEX+smdY1PoScf1plbvge2N14mtsDKQhpXJ7cYH6kUxXvoeoQxrFCkaDCIoVR7Cng1OLfI+8akWCLHzZNCkjexT3epoDZ+7V1YI/4Y1qaOD2x+FJ1UgUGyjHG7nAU1ajsz1f9KuJHipcVzTrN6I1jBIgWEKOKbI/l1JIHz1AqvLGeuSazWr1LIpJC/Wo2T5c1IqZNLIpC8At7CtL9iSjIcKfpVBuvArUlgcL86kA1GkEYOcfnWsTOzZmmJn+lFauB0AAHtRWqIaNcxOn31ZfqMUEnFdreTaRat+9QIf8AprbEfqYzWe2oaEW+/a/Xy/8A7UK441b7o0cWjmCcUbs10j3OiS/L5tqvv5HH8xUbRaMy/LfacP8Aeicfyer9pHqmLU5yRARzzVC4CA5xxXUTWtm3+pvtKx7mUf8AsxqjNpsTnL3enMP9iST/AArWFWKIcWZENv5ihs4FYnjbEGjhA2DNKqdOoHzH/wBBx+NdjHZqBhbu0x2G5h/NRXAfEeXbqNlbq6OI43dtpyMkgD/0FvzrRzVjOSsjyfxFdfaL7y1OY4vlH17/AOfasgnmpJDukY+pJqJutXFaHC3d3LkUn2e0ZgMtMCmfQcZqqKlvOPJj7JGv5n5v61Bk00g8gI5o6d6M0lMD2fwHIZPCmnk9lZfycit9Rz0NZfw8tivg/Tsj7ys35uxrp1tyO1Z21OyPwoorGT2NSJH6KaurCc9DUywmk5WLSuU1ic9FoaJ/StEQHv8AzppjqecaiZpR17Zq7piy7pGROQMc1N5QIwABWjosG3zGPsKrnVikmmVBBM7bmBBPTFc9cNJ5z7mb7x4r0GRlWNj6CubkggmYMyKW9aEypyOdyB60gb0rpJrOCRAAFX3xSW9nFHGVdVYnvVXRKdzAVWboprD8VWp8uCVlyp3Qvj0YZz+mPxrtprIZzGQo9OtZ99pq3tpJBcEhHGMr1B6gj3B5pN6A1dHicceyO8LfeQKn5tz/AOg1XzWvrds1lJeQyjEvnKrjtkAnI9jnP41jjipRgOrtPhqV8zUcY8z939cfNXFZFdZ8M2J8RSxDkPbMfxDL/iaJbDi/eR6gh+X3qSJd7YqaG2XqxJ9qsqoUfKMVyyqLodigxiIF4Ap+KZNcRQ/6xwPbvVN9Tj/5ZozH34qEpS2KuluaAoZgvU1kNqDucMAo9qvwWxnRSJl57ZyaHC3xAnfYdJOp4XJNKIZpFyE2g+taNvbRW68AFu7GmSyjPXNQpdkVy9yrFaBfvUSvHCvyqCadJISOTgVQnkBztI+taxi5bhoiOeVpW5wB6CoD1oZqjZ+Oa6oxtsYscTt60VAWLHjJorRIWh2X2jRkXIj1iMD0lAxUn9r6UyeXLLq8kf8AdlaOQf8Aj2abcapqaD5Nf02Y9+QP/ZKoyalrjA7b6wPGTiSDP61xJcy/4P8AwB6lhl8MSNuKakCfTYKcq+GB21BR6nbWZJc61yWEUh9UiifP5A1UuZdSYZuLXAHdrRR/7LVKPn+P/ADlN4yeGV+692P1qGa80CND5CzSnt5gYfyIrnftMg6pAP8Atgn+FQOdzEnH4DFWod2/vHZdjebUrEf6q2g/4GHP9a8y+J18j6pJLGsS+XaKuI1KjO5z3+orrsV5h8RJ83l+hz9+OMf98K1WoamNd8sbnC01h6UuaPTFdVtDyx90Q1xIQflBwv0HAqPFLRQlZDuJgUh4pStWNNtvteo2lsT/AK6VY/zIFJhvoe4eGRJZ6Bp0JZgywJkehxzWwt3JjhzVLcFAHSnqQelQtT0uWysXobiUt8zZ+oq7DMxYbsYrKib5hV6FgWFKUUNbml1Xg03bSW7dqmNc73NbEW36VqaYu23z6ms1ga2tOQfY0J75oZUVqV7zi2l/3TWOsbHopH1rpLvatm/A5IFZOK3gtDGpuV1ix94/lUoCgU87RUZwelU7W1IV+ghTcpxVRhjirwJqKWNW9RWUpLoaRT6nkHxHG7VZzn/VlF/8dz/WuLzXZ/EQ41bUl/uyxj/yGlcVmqitDnluxa1vCeqHSPEdrckFo9rpIo6lTjp79D+FZGaaCROpHBUZH51TSasyOa2qPo2KcSRq8ZBRhuDDoR2NKZcjqcVyHgXWRPpBtJDukiAZM/8APM9B+ByPYYrTuppWbaWIX0Fcaou9jvjV5lcuX1xG67Fwxz19KoiolPtmhnP0reMVFWRDd2WF5NbekFYI2YDORgfWuaUsTWppdxs3K/AxnOazqK+hcdDbLs3U8VDNMkXU1Qm1NVyIhuPqazpZnlbLkk0Qotg6q6F6bUN+Qo/Gq3nE89DUUcZ6v8q+/epVI6RRlvc1vyxiiLykJlm70h2jrzU32aRsFzgegFK0Ef8AFil7SKK5WV/M9uPYUU6ZyV2W8ftuPAFFNTuTY67UF8xfkPhocciIhT/IViT6fJJgI2nJ/uXaDP5tXU3GmaBOT9nknn4ziK6jJ/J2Brn9SstOt5SFi1GMYz+/AX+QNclOfY2aMprKVWwWgP8Auzof5GoSHhfrg+qtn+VTTLbhf3TsW9Oo/PAqtXQtdySWSaWQYkkdx6MxNR0goqhC14948m36pOM/encn/gIC/wBK9gzivEPFjltZnz/z0kP5yNVQ3OXFP3TFp8Sb2I9FZvyBNNqezxulz/zyf+VbM4ErkFFFFMQVveBbf7R4ntCRlYsyn8Bx+uKwK7P4ZQ5vL24I+5GqD8Tn/wBlpPYumrySPR2O41IjFTVbNPjPzCktjvkaEfJzVmMtn5M1HYR+cxzjArVjtwvUgfSolO2hUY3C1V8Zc/hVoVHvUd6XzBWMpamqRJW5bjbaxqP7ua57zOcVuCQLGBkDArNtmsEVdWcpCq7jy1ZkbFjyWP41LrV0gMYyT1PFZa3wz8oxWycmjKaVzVUelKzBR8xrIe8dujY+lRNI55JJFS4d2TzdjXN0gPy81HJOT3rLVyeByauQwnGXP4Ue7HVg7y2PKfiC2dY1M+s0f/opK42uy+IoxrWogdPNi/8ARS1xua0i7q5xy0bCkXmRj6AClBpsf8Z9W/8ArVRLZ1fgq+FtqFsW6eZ5LH/Zfgf+Pba9NeMu3ArxKxkKTEA4LgqD6Ht+uK9qS9SaGOWEfI6h1+hGaynodFF7olFoAuXfAqF/KTiMAn1NRySs3Umq0kmKhXZ0EzSAUGXMeAMVT37mqzCpkYJHgsepParS6smTbVh0XzMB0rRtrbdyBn3PSpLOwRMNJ87e/Spbu/gthtLZb+6vJqJVnflggjTtqw+zKGzIc+1E1zb2q/OwB9B1rDutUllP7v5F9utZ7OSckkn3p+ylL4mU5JbGxdau8nywrtX1PWore+KKRJuY54NZRfHemNKT0NaqmkrE8zNaa/bHy4Ue/NFYjMT3orRRQuZky+JSPvWyn6P/APWqaPxSsbblhmjYd0fmuVzSVlZGftJHXN4otZm3TC43d2YZ/rUset6e+P3+P95SK4zcPWk3r60+UPas76O+tH+5cRH/AIEBUyyRuPkkVvoc1515gHSjzM9KFEftWehPIF614f4icSakXXoyhvzJP9a7BrqaNGZZHGBn7xrhtSObrB/hVV/QVUVqc1efMirU1p9+T/rk/wD6CahqW24kbHeNx/46a0exzLciooopiCu/8C/6LorMB800pbPsOP5g1wFd/ocgttItYyDwm4/jz/WpkbUPiOkW9YdRmpY7/DDKfrWKLtO4Ipy3MR/ix9aasdl0dZYX6lvkbaemD3rSa4kbo5xXEQTAn5GBHsa6fR3luVCsPo571M0krlLyLwkcNnPPvVpZpZOI0qa3sVHMh3fyq8qqgwoA+lclStHorm0YMpR208jpvkxkjgVsyQSIpJU4HeorMbruL65rakTepB6Hg1kqz6m0II4rWZCZ1HotZmfWtvxBBEtw204YYAGetYwjJ7GuiMuZXM5LUms18yYKemM1pNFuXbwKSxtViXcTljVhvlU56VhObctAUdCCCEQrxyx6ml8wlwq+vJpjSE9OBTM1Nr6sZ5f8TF2azdf7TRt/44B/SuJruPiZ82qyE9fLjb+Y/pXD12U/hPOqfExenNNj/wBWvuM0kn3CB34p/wBKszaHRttkVvQg16t4al36DaFj9xTF/wB8Er/SvJuteh+EZ/M0ojP3ZD+oDH9TUTV0a0HaR0ckwP3ah60gOTgVYjtnbHHBqVY7BsEJkbAFbFrapAA38VMtLYxjJ4qa4nihX5mGfSok23ZDQlxclUIBwPWufm+aRmHc1NeXgk9/THSqLuze1bU6fKtSZSuKzAVEzk9KTBNIeK0M7iNyaSgmkzTAKKKKYHJLK4/jP507z27vVEsfWmEn1qeU4+YvGdR1NJ9qUVROaQ/jRYOZl/7UvrR9p9Gx+FZ/50ZoFzMu3UrG1m+ck7D0+lczfHN5Mf8AbP8AOteQ/KMk4LAH86xJG3uWPc5oRE2R1NZruuUX1yP0qLFWdN4vUIGSASB6nBqnsZoqDpS0rDazKexxSUwFVd7BfU4rtvO2gKoGAMCuP09PMvYV/wBrP5c10jHFTI1p6Fkz/T86Tz/Y1RY803J96EjS5oC4we4rVsdfu7VAsM2AOm4ZxXOAmnqxqWr7jUmtju7fxbf7QGMbD6YNacPjBlH7y3T8GNedRzEDv+BqVbph15+tZujF9DRVpLqes6J4ttpLob4GGAejA10y+IrGROXkjz3K/wCGa8T0e5HnMTx8vatcXXdXIP1rGVBXOinXlbU7a41LTpruTZcRsxbHJ5P51aRFKZJG2vJmvGaVixByx7VKl22MLI6/RsVp7LSyYvb3eqPTZtRgi+WNgzDjioUuDNkls+1efpeTr0lJ+vNWYdXuomypQn3FHskkHtrndZpAfWuSi8Q3Z+9HEfoCP61MPEUo+9Av4NWbpstVInKfFCUx6ucAFTbxn3+89cP9qX+61dV8QLz7deNLs2YgjXGc9Hb/ABri66acfdPOrTfO7GnpA+3ata2zDEckgB9cU+6jaKd0cYYHkeh9KPCe0eILRm6KWb/x01Z8Vbo9TmePHls24ZHPPP8APd+VN72FF+7zMoEhRljgV2Hw5cXKXkbNwrKwH1yP6CuAZmc/MSa6v4bz+XqtwhPDQkjnuGH+NOUdB06nvqx6vbwRIoOB+NWjcwwrliBWIbgnpxTGbd1Oay5E9z0FIvXWrMwKwDaP7x61mSSO5yxJ+tPKgUxsVpGKjsKTbGU057Cn0maskYQx9qTYfUVJQRQIgKkUnSpGUk0u0UARg0VIR6CimM8+zRupMUYqTgAn0pMmlyB2pM+1IYmaM0UlAEd2222c9+1Yua1NSb9wAP71ZVNIzluFXtHi8y83HogzVGtfQ02wySf3mA/L/wDXRJ2QRV2Zdx/x8S/75/nUVSTczOfViaZVEvcu6QM3RP8AdUmtR2NUNGTmZz7AVekIqWXHYjzTSTQwpCKopsNxHc/nS+Yw/iP503FIeKLCuSi4kHRqUXUncg/hUIOKKLBdm1o9y2JGKjHArSe7VY2LKQADWRpYxbk+rVPeHFrLn+6ahrU2i2kVFuU7OR9amW4PZwfxrGozVcqMudm6Llh609b1x3NYKuw6MR+NOE8g/jNHKPnOii1F19DUy6mP4o/yNcx9pl/vfpThdSd8flS5ClULHiSdZ97ICP3ajn2b/wCvXOVq3UjTK4OP9WTx9RWSKaVjGbu7mr4c41QNnGEOP8/jWtriGYLnncpXPoRyP61haRJ5d0zYz8hH6itO5ud0JwpyDu60mVFrlszn+hxWh4flMWqR4/iBX9Kgv49k+4fdcZqOyYpeQsDjDinuiFpI7tb6aP7rsPxqVdauE67W+orGNwfao2n9RUpHTzvudJH4gOP3kP5NUn9vQnrFJ+GK5Tz175FKLlPWnqP2rOrGuW/eOX8h/jThrVqe0o/4D/8AXrk/PHbFI03vQHtWdeNZsz/Gw+q05dXsj1nA/wCAmuKaWm+bTD2zO7Gp2R6XCfjxQdQtB/y8xfnXCeb9KRpaA9s+x3LarZD/AJbr+porhPOP+TRRqHtmSZpNxphoqTEfmkzTaBQAuaO9Nao2YgHFMCvqTA7VB571n1c1H/j4A7BRiqlCMm9RK3LP91pwPfaWrE/irdbi0UdsKKJalQMWcbZ3B7MRTKkuv+PqT/eNR0yDV0v5bU+7E/yqZzVaz4tV/H+dPY0Gq2HM1IGOajzTSTmqFcmzSZ9ah3H1pyEkUBckpKRaDQFzb00YtFz35pNSOLRvcgU+x/49I/pUGrH9wv8AvVHU2+yZNGKKKswExRQetIKACilpDQA6PmTHqjD+VZVacP8Ax9J/un+lZbffP1pdSWXNNx5rf7tXWb5qoaf/AKx/pVs9aLFLYSVDNaYH3ozgfh/9assEqwPpzWxAfncdsA1lXAxM4HTNJBLuapJ9ab5jDoxpE/1S/wC6P5U09aoLknnN3waTzM9ajooAk3UobB61Fnmgk0C5icvTd9RZNISaBpk2+k31ECadmgLjw3NFRDrRSYXP/9k=");
    background-repeat: none;
    background-size: cover;
    background-position: 50% 50%;
}

.card {
    z-index: 1;
    background-color: rgba(0, 0, 0, .3);
    color: #fff;
    border: .25rem solid #fff;
    border-radius: 1rem;
    max-width: 90%;
    padding: 1rem;
    display: flex;
    flex-direction: column;
}

.card > * {
    margin: .75rem;
    border-radius: 2rem;
    font-size: 1.5rem;
}

input[type=text], .card > button {
    padding: .5rem 1.5rem;
    color: #fff;
    border: .125rem solid #fff;
}

input[type=text] {
    background-color: rgba(0,0,0, 0.5);
}

.card > button {
    background-color: rgba(255,255,255, 0.5);
}

input[type=text]:focus, .card > button:focus {
    outline: .25rem solid #fff;
    outline-offset: -2px;
}

input[type=text]::placeholder {
    color: #aaa;
    text-align: right;
}

.input-control {
    position: relative;
}

.tip {
    background-color: transparent;
    color: #fff;
    text-align: center;
}

.tip.error {
    color: yellow;
}
)x";

// index.js
String index_js = R"x(
const cityIds = (() => {
    const result = {};
    `北京,010100;海淀,010200;朝阳,010300;顺义,010400;怀柔,010500;通州,010600;昌平,010700;延庆,010800;丰台,010900;石景山,011000;大兴,011100;房山,011200;密云,011300;门头沟,011400;平谷,011500;八达岭,011600;佛爷顶,011700;汤河口,011800;密云上甸子,011900;斋堂,012000;霞云岭,012100;上海,020100;闵行,020200;宝山,020300;川沙,020400;嘉定,020500;南汇,020600;金山,020700;青浦,020800;松江,020900;奉贤,021000;崇明,021100;陈家镇,021101;引水船,021102;徐家汇,021200;浦东,021300;天津,030100;武清,030200;宝坻,030300;东丽,030400;西青,030500;北辰,030600;宁河,030700;汉沽,030800;静海,030900;津南,031000;塘沽,031100;大港,031200;平台,031300;蓟县,031400;重庆,040100;永川,040200;合川,040300;南川,040400;江津,040500;万盛,040600;渝北,040700;北碚,040800;巴南,040900;长寿,041000;黔江,041100;万州天城,041200;万州龙宝,041300;涪陵,041400;开县,041500;城口,041600;云阳,041700;巫溪,041800;奉节,041900;巫山,042000;潼南,042100;垫江,042200;梁平,042300;忠县,042400;石柱,042500;大足,042600;荣昌,042700;铜梁,042800;璧山,042900;丰都,043000;武隆,043100;彭水,043200;綦江,043300;酉阳,043400;金佛山,043500;秀山,043600;沙坪坝,043700;哈尔滨,050101;双城,050102;呼兰,050103;阿城,050104;宾县,050105;依兰,050106;巴彦,050107;通河,050108;方正,050109;延寿,050110;尚志,050111;五常,050112;木兰,050113;齐齐哈尔,050201;讷河,050202;龙江,050203;甘南,050204;富裕,050205;依安,050206;拜泉,050207;克山,050208;克东,050209;泰来,050210;牡丹江,050301;海林,050302;穆棱,050303;林口,050304;绥芬河,050305;宁安,050306;东宁,050307;佳木斯,050401;汤原,050402;抚远,050403;桦川,050404;桦南,050405;同江,050406;富锦,050407;绥化,050501;肇东,050502;安达,050503;海伦,050504;明水,050505;望奎,050506;兰西,050507;青冈,050508;庆安,050509;绥棱,050510;黑河,050601;嫩江,050602;孙吴,050603;逊克,050604;五大连池,050605;北安,050606;大兴安岭,050701;塔河,050702;漠河,050703;呼玛,050704;呼中,050705;新林,050706;阿木尔,050707;加格达奇,050708;伊春,050801;乌伊岭,050802;五营,050803;铁力,050804;嘉荫,050805;大庆,050901;林甸,050902;肇州,050903;肇源,050904;杜蒙,050905;七台河,051002;勃利,051003;鸡西,051101;虎林,051102;密山,051103;鸡东,051104;鹤岗,051201;绥滨,051202;萝北,051203;双鸭山,051301;集贤,051302;宝清,051303;饶河,051304;长春,060101;农安,060102;德惠,060103;九台,060104;榆树,060105;双阳,060106;吉林,060201;舒兰,060202;永吉,060203;蛟河,060204;磐石,060205;桦甸,060206;烟筒山,060207;延吉,060301;敦化,060302;安图,060303;汪清,060304;和龙,060305;天池,060306;龙井,060307;珲春,060308;图们,060309;松江,060310;罗子沟,060311;延边,060312;四平,060401;双辽,060402;梨树,060403;公主岭,060404;伊通,060405;孤家子,060406;通化,060501;梅河口,060502;柳河,060503;辉南,060504;集安,060505;通化县,060506;白城,060601;洮南,060602;大安,060603;镇赉,060604;通榆,060605;辽源,060701;东丰,060702;松原,060801;乾安,060802;前郭,060803;长岭,060804;扶余,060805;白山,060901;靖宇,060902;临江,060903;东岗,060904;长白,060905;沈阳,070101;苏家屯,070102;辽中,070103;康平,070104;法库,070105;新民,070106;于洪,070107;新城子,070108;大连,070201;瓦房店,070202;金州,070203;普兰店,070204;旅顺,070205;长海,070206;庄河,070207;皮口,070208;海洋岛,070209;鞍山,070301;台安,070302;岫岩,070303;海城,070304;抚顺,070401;清原,070403;章党,070404;本溪,070501;本溪县,070502;草河口,070503;桓仁,070504;丹东,070601;凤城,070602;宽甸,070603;东港,070604;东沟,070605;锦州,070701;凌海,070702;北宁,070703;义县,070704;黑山,070705;北镇,070706;营口,070801;大石桥,070802;盖州,070803;阜新,070901;彰武,070902;辽阳,071001;辽阳县,071002;灯塔,071003;铁岭,071101;开原,071102;昌图,071103;西丰,071104;朝阳,071201;建平,071202;凌源,071203;喀左,071204;北票,071205;羊山,071206;建平县,071207;盘锦,071301;大洼,071302;盘山,071303;葫芦岛,071401;建昌,071402;绥中,071403;兴城,071404;呼和浩特,080101;土默特左旗,080102;托克托,080103;和林格尔,080104;清水河,080105;呼和浩特市郊区,080106;武川,080107;包头,080201;白云鄂博,080202;满都拉,080203;土默特右旗,080204;固阳,080205;达尔罕茂明安联合旗,080206;石拐,080207;乌海,080301;集宁,080401;卓资,080402;化德,080403;商都,080404;希拉穆仁,080405;兴和,080406;凉城,080407;察哈尔右翼前旗,080408;察哈尔右翼中旗,080409;察哈尔右翼后旗,080410;四子王旗,080411;丰镇,080412;通辽,080501;舍伯吐,080502;科尔沁左翼中旗,080503;科尔沁左翼后旗,080504;青龙山,080505;开鲁,080506;库伦旗,080507;奈曼旗,080508;扎鲁特旗,080509;高力板,080510;巴雅尔吐胡硕,080511;通辽钱家店,080512;赤峰,080601;赤峰郊区站,080602;阿鲁科尔沁旗,080603;浩尔吐,080604;巴林左旗,080605;巴林右旗,080606;林西,080607;克什克腾旗,080608;翁牛特旗,080609;岗子,080610;喀喇沁旗,080611;八里罕,080612;宁城,080613;敖汉旗,080614;宝过图,080615;鄂尔多斯,080701;达拉特旗,080703;准格尔旗,080704;鄂托克前旗,080705;河南,080706;伊克乌素,080707;鄂托克旗,080708;杭锦旗,080709;乌审旗,080710;伊金霍洛旗,080711;乌审召,080712;东胜,080713;临河,080801;五原,080802;磴口,080803;乌拉特前旗,080804;大佘太,080805;乌拉特中旗,080806;乌拉特后旗,080807;海力素,080808;那仁宝力格,080809;杭锦后旗,080810;巴盟农试站,080811;锡林浩特,080901;朝克乌拉,080902;二连浩特,080903;阿巴嘎旗,080904;伊和郭勒,080905;苏尼特左旗,080906;苏尼特右旗,080907;朱日和,080908;东乌珠穆沁旗,080909;西乌珠穆沁旗,080910;太仆寺旗,080911;镶黄旗,080912;正镶白旗,080913;正兰旗,080914;多伦,080915;博克图,080916;乌拉盖,080917;白日乌拉,080918;那日图,080919;呼伦贝尔,081000;海拉尔,081001;小二沟,081002;阿荣旗,081003;莫力达瓦旗,081004;鄂伦春旗,081005;鄂温克旗,081006;陈巴尔虎旗,081007;新巴尔虎左旗,081008;新巴尔虎右旗,081009;满洲里,081010;牙克石,081011;扎兰屯,081012;额尔古纳,081014;根河,081015;图里河,081016;乌兰浩特,081101;阿尔山,081102;科尔沁右翼中旗,081103;胡尔勒,081104;扎赉特旗,081105;索伦,081106;突泉,081107;霍林郭勒,081108;阿拉善左旗,081201;阿拉善右旗,081202;额济纳旗,081203;拐子湖,081204;吉兰太,081205;锡林高勒,081206;头道湖,081207;中泉子,081208;巴彦诺尔贡,081209;雅布赖,081210;乌斯太,081211;孪井滩,081212;石家庄,090101;井陉,090102;正定,090103;栾城,090104;行唐,090105;灵寿,090106;高邑,090107;深泽,090108;赞皇,090109;无极,090110;平山,090111;元氏,090112;赵县,090113;辛集,090114;藁城,090115;晋洲,090116;新乐,090117;保定,090201;满城,090202;阜平,090203;徐水,090204;唐县,090205;高阳,090206;容城,090207;紫荆关,090208;涞源,090209;望都,090210;安新,090211;易县,090212;涞水,090213;曲阳,090214;蠡县,090215;顺平,090216;雄县,090217;涿州,090218;定州,090219;安国,090220;高碑店,090221;张家口,090301;宣化,090302;张北,090303;康保,090304;沽源,090305;尚义,090306;蔚县,090307;阳原,090308;怀安,090309;万全,090310;怀来,090311;涿鹿,090312;赤城,090313;崇礼,090314;承德,090402;承德县,090403;兴隆,090404;平泉,090405;滦平,090406;隆化,090407;丰宁,090408;宽城,090409;围场,090410;塞罕坎,090411;唐山,090501;丰南,090502;丰润,090503;滦县,090504;滦南,090505;乐亭,090506;迁西,090507;玉田,090508;唐海,090509;遵化,090510;迁安,090511;廊坊,090601;固安,090602;永清,090603;香河,090604;大城,090605;文安,090606;大厂,090607;霸州,090608;三河,090609;沧州,090701;青县,090702;东光,090703;海兴,090704;盐山,090705;肃宁,090706;南皮,090707;吴桥,090708;献县,090709;孟村,090710;泊头,090711;任丘,090712;黄骅,090713;河间,090714;曹妃甸,090715;衡水,090801;枣强,090802;武邑,090803;武强,090804;饶阳,090805;安平,090806;故城,090807;景县,090808;阜城,090809;冀州,090810;深州,090811;邢台,090901;临城,090902;邢台县浆水,090903;内邱,090904;柏乡,090905;隆尧,090906;南和,090907;宁晋,090908;巨鹿,090909;新河,090910;广宗,090911;平乡,090912;威县,090913;清河,090914;临西,090915;南宫,090916;沙河,090917;任县,090918;邯郸,091001;峰峰,091002;临漳,091003;成安,091004;大名,091005;涉县,091006;磁县,091007;肥乡,091008;永年,091009;邱县,091010;鸡泽,091011;广平,091012;馆陶,091013;魏县,091014;曲周,091015;武安,091016;秦皇岛,091101;青龙,091102;昌黎,091103;抚宁,091104;卢龙,091105;北戴河,091106;太原,100101;清徐,100102;阳曲,100103;娄烦,100104;太原古交区,100105;太原北郊,100106;太原南郊,100107;大同,100201;阳高,100202;大同县,100203;天镇,100204;广灵,100205;灵邱,100206;浑源,100207;左云,100208;阳泉,100301;盂县,100302;平定,100303;晋中,100401;榆次,100402;榆社,100403;左权,100404;和顺,100405;昔阳,100406;寿阳,100407;太谷,100408;祁县,100409;平遥,100410;灵石,100411;介休,100412;长治,100501;黎城,100502;屯留,100503;潞城,100504;襄垣,100505;平顺,100506;武乡,100507;沁县,100508;长子,100509;沁源,100510;壶关,100511;晋城,100601;沁水,100602;阳城,100603;陵川,100604;高平,100605;临汾,100701;曲沃,100702;永和,100703;隰县,100704;大宁,100705;吉县,100706;襄汾,100707;蒲县,100708;汾西,100709;洪洞,100710;霍州,100711;乡宁,100712;翼城,100713;侯马,100714;浮山,100715;安泽,100716;古县,100717;运城,100801;临猗,100802;稷山,100803;万荣,100804;河津,100805;新绛,100806;绛县,100807;闻喜,100808;垣曲,100809;永济,100810;芮城,100811;夏县,100812;平陆,100813;朔州,100901;平鲁,100902;山阴,100903;右玉,100904;应县,100905;怀仁,100906;忻州,101001;定襄,101002;五台县豆村,101003;河曲,101004;偏关,101005;神池,101006;宁武,101007;代县,101008;繁峙,101009;五台山,101010;保德,101011;静乐,101012;岢岚,101013;五寨,101014;原平,101015;吕梁,101100;离石,101101;临县,101102;兴县,101103;岚县,101104;柳林,101105;石楼,101106;方山,101107;交口,101108;中阳,101109;孝义,101110;汾阳,101111;文水,101112;交城,101113;西安,110101;长安,110102;临潼,110103;蓝田,110104;周至,110105;户县,110106;高陵,110107;杨凌,110108;咸阳,110200;三原,110201;礼泉,110202;永寿,110203;淳化,110204;泾阳,110205;武功,110206;乾县,110207;彬县,110208;长武,110209;旬邑,110210;兴平,110211;延安,110300;延长,110301;延川,110302;子长,110303;宜川,110304;富县,110305;志丹,110306;安塞,110307;甘泉,110308;洛川,110309;黄陵,110310;黄龙,110311;吴起,110312;榆林,110401;府谷,110402;神木,110403;佳县,110404;定边,110405;靖边,110406;横山,110407;米脂,110408;子洲,110409;绥德,110410;吴堡,110411;清涧,110412;渭南,110501;华县,110502;潼关,110503;大荔,110504;白水,110505;富平,110506;蒲城,110507;澄城,110508;合阳,110509;韩城,110510;华阴,110511;华山,110512;商洛,110601;洛南,110602;柞水,110603;镇安,110605;丹凤,110606;商南,110607;山阳,110608;安康,110701;紫阳,110702;石泉,110703;汉阴,110704;旬阳,110705;岚皋,110706;平利,110707;白河,110708;镇坪,110709;宁陕,110710;汉中,110801;略阳,110802;勉县,110803;留坝,110804;洋县,110805;城固,110806;西乡,110807;佛坪,110808;宁强,110809;南郑,110810;镇巴,110811;宝鸡,110901;宝鸡县,110902;千阳,110903;麟游,110904;岐山,110905;凤翔,110906;扶风,110907;眉县,110908;太白,110909;凤县,110910;陇县,110911;铜川,111001;耀县,111002;宜君,111003;济南,120101;长清,120102;商河,120103;章丘,120104;平阴,120105;济阳,120106;青岛,120201;崂山,120202;潮连岛,120203;即墨,120204;胶州,120205;胶南,120206;莱西,120207;平度,120208;淄博,120301;淄川,120302;博山,120303;高青,120304;周村,120305;沂源,120306;桓台,120307;临淄,120308;德州,120401;武城,120402;临邑,120403;陵县,120404;齐河,120405;乐陵,120406;庆云,120407;平原,120408;宁津,120409;夏津,120410;禹城,120411;烟台,120501;莱州,120502;长岛,120503;蓬莱,120504;龙口,120505;招远,120506;栖霞,120507;福山,120508;牟平,120509;莱阳,120510;海阳,120511;千里岩,120512;潍坊,120601;青州,120602;寿光,120603;临朐,120604;昌乐,120605;昌邑,120606;安丘,120607;高密,120608;诸城,120609;济宁,120701;嘉祥,120702;微山,120703;鱼台,120704;兖州,120705;金乡,120706;汶上,120707;泗水,120708;梁山,120709;曲阜,120710;邹城,120711;泰安,120801;新泰,120802;泰山,120803;肥城,120804;东平,120805;宁阳,120806;临沂,120901;莒南,120902;沂南,120903;苍山,120904;临沭,120905;郯城,120906;蒙阴,120907;平邑,120908;费县,120909;沂水,120910;马站,120911;菏泽,121001;鄄城,121002;郓城,121003;东明,121004;定陶,121005;巨野,121006;曹县,121007;成武,121008;单县,121009;滨州,121101;博兴,121102;无棣,121103;阳信,121104;惠民,121105;沾化,121106;邹平,121107;东营,121201;河口,121202;垦利,121203;利津,121204;广饶,121205;威海,121301;文登,121302;荣成,121303;乳山,121304;成山头,121305;石岛,121306;枣庄,121401;薛城,121402;峄城,121403;台儿庄,121404;滕州,121405;日照,121501;五莲,121502;莒县,121503;莱芜,121601;聊城,121701;冠县,121702;阳谷,121703;高唐,121704;茌平,121705;东阿,121706;临清,121707;朝城,121708;莘县,121709;乌鲁木齐,130101;蔡家湖,130102;小渠子,130103;巴仑台,130104;达坂城,130105;十三间房气象站,130106;天山大西沟,130107;乌鲁木齐牧试站,130108;天池,130109;白杨沟,130110;克拉玛依,130201;石河子,130301;炮台,130302;莫索湾,130303;乌兰乌苏,130304;昌吉,130401;呼图壁,130402;米泉,130403;阜康,130404;吉木萨尔,130405;奇台,130406;玛纳斯,130407;木垒,130408;北塔山,130409;吐鲁番,130501;托克逊,130502;吐鲁番东坎,130503;鄯善,130504;红柳河,130505;库尔勒,130601;轮台,130602;尉犁,130603;若羌,130604;且末,130605;和静,130606;焉耆,130607;和硕,130608;库米什,130609;巴音布鲁克,130610;铁干里克,130611;博湖,130612;塔中,130613;阿拉尔,130701;阿克苏,130801;乌什,130802;温宿,130803;拜城,130804;新和,130805;沙雅,130806;库车,130807;柯坪,130808;阿瓦提,130809;喀什,130901;英吉沙,130902;塔什库尔干,130903;麦盖提,130904;莎车,130905;叶城,130906;泽普,130907;巴楚,130908;岳普湖,130909;伽师,130910;伊宁,131001;察布查尔,131002;尼勒克,131003;伊宁县,131004;巩留,131005;新源,131006;昭苏,131007;特克斯,131008;霍城,131009;霍尔果斯,131010;塔城,131101;裕民,131102;额敏,131103;和布克赛尔,131104;托里,131105;乌苏,131106;沙湾,131107;和丰,131108;哈密,131201;沁城,131202;巴里坤,131203;伊吾,131204;淖毛湖,131205;和田,131301;皮山,131302;策勒,131303;墨玉,131304;洛浦,131305;民丰,131306;于田,131307;阿勒泰,131401;哈巴河,131402;一八五团,131403;黑山头,131404;吉木乃,131405;布尔津,131406;福海,131407;富蕴,131408;青河,131409;安德河,131410;阿图什,131501;乌恰,131502;阿克陶,131503;阿合奇,131504;吐尔尕特,131505;博乐,131601;温泉,131602;精河,131603;阿拉山口,131606;拉萨,140101;当雄,140102;尼木,140103;墨竹贡卡,140104;日喀则,140201;拉孜,140202;南木林,140203;聂拉木,140204;定日,140205;江孜,140206;帕里,140207;山南,140301;贡嘎,140302;琼结,140303;加查,140304;浪卡子,140305;错那,140306;隆子,140307;泽当,140308;林芝,140401;波密,140402;米林,140403;察隅,140404;昌都,140501;丁青,140502;类乌齐,140503;洛隆,140504;左贡,140505;芒康,140506;八宿,140507;那曲,140601;嘉黎,140603;班戈,140604;安多,140605;索县,140606;比如,140607;阿里,140701;改则,140702;申扎,140703;狮泉河,140704;普兰,140705;西宁,150101;大通,150102;湟源,150103;湟中,150104;铁卜加,150105;铁卜加寺,150106;中心站,150107;海东,150201;乐都,150202;民和,150203;互助,150204;化隆,150205;循化,150206;冷湖,150207;平安,150208;黄南,150301;尖扎,150302;泽库,150303;河南,150304;海南,150401;江西沟,150402;贵德,150404;河卡,150405;兴海,150406;贵南,150407;同德,150408;共和,150409;果洛,150501;班玛,150502;甘德,150503;达日,150504;久治,150505;玛多,150506;清水河,150507;玛沁,150508;玉树,150601;托托河,150602;治多,150603;杂多,150604;囊谦,150605;曲麻莱,150606;海西,150701;格尔木,150702;察尔汉,150703;野牛沟,150704;五道梁,150705;小灶火,150706;天峻,150708;乌兰,150709;都兰,150710;诺木洪,150711;茫崖,150712;大柴旦,150713;茶卡,150714;香日德,150715;德令哈,150716;海北,150801;门源,150802;祁连,150803;海晏,150804;托勒,150805;刚察,150806;兰州,160101;皋兰,160102;永登,160103;榆中,160104;定西,160201;通渭,160202;陇西,160203;渭源,160204;临洮,160205;漳县,160206;岷县,160207;安定,160208;平凉,160301;泾川,160302;灵台,160303;崇信,160304;华亭,160305;庄浪,160306;静宁,160307;崆峒,160308;庆阳,160401;西峰,160402;环县,160403;华池,160404;合水,160405;正宁,160406;宁县,160407;镇原,160408;庆城,160409;武威,160501;民勤,160502;古浪,160503;乌鞘岭,160504;天祝,160505;金昌,160601;永昌,160602;张掖,160701;肃南,160702;民乐,160703;临泽,160704;高台,160705;山丹,160706;酒泉,160801;鼎新,160802;金塔,160803;马鬃山,160804;瓜州,160805;肃北,160806;玉门镇,160807;敦煌,160808;天水,160901;北道区,160902;清水,160903;秦安,160904;甘谷,160905;武山,160906;张家川,160907;麦积,160908;武都,161001;成县,161002;文县,161003;宕昌,161004;康县,161005;西和,161006;礼县,161007;徽县,161008;两当,161009;临夏,161101;康乐,161102;永靖,161103;广河,161104;和政,161105;东乡,161106;合作,161201;临潭,161202;卓尼,161203;舟曲,161204;迭部,161205;玛曲,161206;碌曲,161207;夏河,161208;白银,161301;靖远,161302;会宁,161303;华家岭,161304;景泰,161305;银川,170101;永宁,170102;灵武,170103;贺兰,170104;石嘴山,170201;惠农,170202;平罗,170203;陶乐,170204;石炭井,170205;大武口,170206;吴忠,170301;同心,170302;盐池,170303;韦州,170304;麻黄山,170305;青铜峡,170306;固原,170401;西吉,170402;隆德,170403;泾源,170404;六盘山,170405;彭阳,170406;中卫,170501;中宁,170502;兴仁堡,170503;海原,170504;郑州,180101;巩义,180102;荥阳,180103;登封,180104;新密,180105;新郑,180106;中牟,180107;郑州农试站,180108;安阳,180201;汤阴,180202;滑县,180203;内黄,180204;林州,180205;新乡,180301;获嘉,180302;原阳,180303;辉县,180304;卫辉,180305;延津,180306;封丘,180307;长垣,180308;许昌,180401;鄢陵,180402;襄城,180403;长葛,180404;禹州,180405;平顶山,180501;郏县,180502;宝丰,180503;汝州,180504;叶县,180505;舞钢,180506;鲁山,180507;信阳,180601;息县,180602;罗山,180603;光山,180604;新县,180605;淮滨,180606;潢川,180607;固始,180608;商城,180609;鸡公山,180610;信阳地区农试站,180611;南阳,180701;南召,180702;方城,180703;社旗,180704;西峡,180705;内乡,180706;镇平,180707;淅川,180708;新野,180709;唐河,180710;邓州,180711;桐柏,180712;开封,180801;杞县,180802;尉氏,180803;通许,180804;兰考,180805;洛阳,180901;新安,180902;孟津,180903;宜阳,180904;洛宁,180905;伊川,180906;嵩县,180907;偃师,180908;栾川,180909;汝阳,180910;商丘,181001;睢阳区,181002;睢县,181003;民权,181004;虞城,181005;柘城,181006;宁陵,181007;夏邑,181008;永城,181009;焦作,181101;修武,181102;武陟,181103;沁阳,181104;博爱,181106;温县,181107;孟州,181108;鹤壁,181201;浚县,181202;淇县,181203;濮阳,181301;台前,181302;南乐,181303;清丰,181304;范县,181305;周口,181401;扶沟,181402;太康,181403;淮阳,181404;西华,181405;商水,181406;项城,181407;郸城,181408;鹿邑,181409;沈丘,181410;黄泛区,181411;漯河,181501;临颍,181502;舞阳,181503;驻马店,181601;西平,181602;遂平,181603;上蔡,181604;汝南,181605;泌阳,181606;平舆,181607;新蔡,181608;确山,181609;正阳,181610;三门峡,181701;灵宝,181702;渑池,181703;卢氏,181704;济源,181801;南京,190101;溧水,190102;高淳,190103;江宁,190104;六合,190105;江浦,190106;浦口,190107;无锡,190201;江阴,190202;宜兴,190203;镇江,190301;丹阳,190302;扬中,190303;句容,190304;丹徒,190305;苏州,190401;常熟,190402;张家港,190403;昆山,190404;吴县东山,190405;吴县,190406;吴江,190407;太仓,190408;南通,190501;海安,190502;如皋,190503;如东,190504;吕泗,190505;吕泗渔场,190506;启东,190507;海门,190508;通州,190509;扬州,190601;宝应,190602;仪征,190603;高邮,190604;江都,190605;邗江,190606;盐城,190701;响水,190702;滨海,190703;阜宁,190704;射阳,190705;建湖,190706;东台,190707;大丰,190708;盐都,190709;徐州,190801;徐州农试站,190802;丰县,190803;沛县,190804;邳州,190805;睢宁,190806;新沂,190807;淮安,190901;金湖,190902;盱眙,190903;洪泽,190904;涟水,190905;淮阴县,190906;淮阴,190907;楚州,190908;连云港,191001;东海,191002;赣榆,191003;灌云,191004;灌南,191005;西连岛,191006;燕尾港,191007;常州,191101;溧阳,191102;金坛,191103;泰州,191201;兴化,191202;泰兴,191203;姜堰,191204;靖江,191205;宿迁,191301;沭阳,191302;泗阳,191303;泗洪,191304;武汉,200101;蔡甸,200102;黄陂,200103;新洲,200104;江夏,200105;襄樊,200201;襄阳,200202;保康,200203;南漳,200204;宜城,200205;老河口,200206;谷城,200207;枣阳,200208;鄂州,200301;孝感,200401;安陆,200402;云梦,200403;大悟,200404;应城,200405;汉川,200406;黄冈,200501;红安,200502;麻城,200503;罗田,200504;英山,200505;浠水,200506;蕲春,200507;黄梅,200508;武穴,200509;黄石,200601;大冶,200602;阳新,200603;咸宁,200701;赤壁,200702;嘉鱼,200703;崇阳,200704;通城,200705;通山,200706;荆州,200801;江陵,200802;公安,200803;石首,200804;监利,200805;洪湖,200806;松滋,200807;宜昌,200901;远安,200902;秭归,200903;兴山,200904;宜昌县,200905;五峰,200906;当阳,200907;长阳,200908;宜都,200909;枝江,200910;三峡,200911;夷陵,200912;恩施,201001;利川,201002;建始,201003;咸丰,201004;宣恩,201005;鹤峰,201006;来凤,201007;巴东,201008;绿葱坡,201009;十堰,201101;竹溪,201102;郧西,201103;郧县,201104;竹山,201105;房县,201106;丹江口,201107;神农架,201201;随州,201301;广水,201302;荆门,201401;钟祥,201402;京山,201403;天门,201501;仙桃,201601;潜江,201701;杭州,210101;萧山,210102;桐庐,210103;淳安,210104;建德,210105;余杭,210106;临安,210107;富阳,210108;湖州,210201;长兴,210202;安吉,210203;德清,210204;嘉兴,210301;嘉善,210302;海宁,210303;桐乡,210304;平湖,210305;海盐,210306;宁波,210401;慈溪,210403;余姚,210404;奉化,210405;象山,210406;石浦,210407;宁海,210408;鄞县,210409;北仑,210410;鄞州,210411;镇海,210412;绍兴,210501;诸暨,210502;上虞,210503;新昌,210504;嵊州,210505;台州,210601;括苍山,210602;玉环,210603;三门,210604;天台,210605;仙居,210606;温岭,210607;大陈,210608;洪家,210609;温州,210701;泰顺,210702;文成,210703;平阳,210704;瑞安,210705;洞头,210706;乐清,210707;永嘉,210708;苍南,210709;丽水,210801;遂昌,210802;龙泉,210803;缙云,210804;青田,210805;云和,210806;庆元,210807;金华,210901;浦江,210902;兰溪,210903;义乌,210904;东阳,210905;武义,210906;永康,210907;磐安,210908;衢州,211001;常山,211002;开化,211003;龙游,211004;江山,211005;舟山,211101;嵊泗,211102;嵊山,211103;岱山,211104;普陀,211105;定海,211106;合肥,220101;长丰,220102;肥东,220103;肥西,220104;蚌埠,220201;怀远,220202;固镇,220203;五河,220204;芜湖,220301;繁昌,220302;芜湖县,220303;南陵,220304;淮南,220401;凤台,220402;马鞍山,220501;当涂,220502;安庆,220601;枞阳,220602;太湖,220603;潜山,220604;怀宁,220605;宿松,220606;望江,220607;岳西,220608;桐城,220609;宿州,220701;砀山,220702;灵璧,220703;泗县,220704;萧县,220705;阜阳,220801;阜南,220802;颍上,220803;临泉,220804;界首,220805;太和,220806;亳州,220901;涡阳,220902;利辛,220903;蒙城,220904;黄山站,221001;黄山区,221002;屯溪,221003;祁门,221004;黟县,221005;歙县,221006;休宁,221007;黄山市,221008;滁州,221101;凤阳,221102;明光,221103;定远,221104;全椒,221105;来安,221106;天长,221107;淮北,221201;濉溪,221202;铜陵,221301;宣城,221401;泾县,221402;旌德,221403;宁国,221404;绩溪,221405;广德,221406;郎溪,221407;六安,221501;霍邱,221502;寿县,221503;南溪,221504;金寨,221505;霍山,221506;舒城,221507;巢湖,221601;庐江,221602;无为,221603;含山,221604;和县,221605;池州,221701;东至,221702;青阳,221703;九华山,221704;石台,221705;福州,230101;闽清,230102;闽侯,230103;罗源,230104;连江,230105;马祖,230106;永泰,230107;平潭,230108;福州郊区,230109;长乐,230110;福清,230111;平潭海峡大桥,230112;厦门,230201;同安,230202;宁德,230301;古田,230302;霞浦,230303;寿宁,230304;周宁,230305;福安,230306;柘荣,230307;福鼎,230308;屏南,230309;莆田,230401;仙游,230402;秀屿港,230403;泉州,230501;安溪,230502;九仙山,230503;永春,230504;德化,230505;南安,230506;崇武,230507;金山,230508;晋江,230509;漳州,230601;长泰,230602;南靖,230603;平和,230604;龙海,230605;漳浦,230606;诏安,230607;东山,230608;云霄,230609;华安,230610;龙岩,230701;长汀,230702;连城,230703;武平,230704;上杭,230705;永定,230706;漳平,230707;三明,230801;宁化,230802;清流,230803;泰宁,230804;将乐,230805;建宁,230806;明溪,230807;沙县,230808;尤溪,230809;永安,230810;大田,230811;南平,230901;顺昌,230902;光泽,230903;邵武,230904;武夷山,230905;浦城,230906;建阳,230907;松溪,230908;政和,230909;建瓯,230910;南昌,240101;新建,240102;南昌县,240103;安义,240104;进贤,240105;莲塘,240106;九江,240201;瑞昌,240202;庐山,240203;武宁,240204;德安,240205;永修,240206;湖口,240207;彭泽,240208;星子,240209;都昌,240210;棠荫,240211;修水,240212;上饶,240301;鄱阳,240302;婺源,240303;康山,240304;余干,240305;万年,240306;德兴,240307;上饶县,240308;弋阳,240309;横峰,240310;铅山,240311;玉山,240312;广丰,240313;波阳,240314;抚州,240401;广昌,240402;乐安,240403;崇仁,240404;金溪,240405;资溪,240406;宜黄,240407;南城,240408;南丰,240409;黎川,240410;东乡,240411;宜春,240501;铜鼓,240502;宜丰,240503;万载,240504;上高,240505;靖安,240506;奉新,240507;高安,240508;樟树,240509;丰城,240510;吉安,240601;吉安县,240602;吉水,240603;新干,240604;峡江,240605;永丰,240606;永新,240607;井冈山,240608;万安,240609;遂川,240610;泰和,240611;安福,240612;宁冈,240613;赣州,240701;崇义,240702;上犹,240703;南康,240704;大余,240705;信丰,240706;宁都,240707;石城,240708;瑞金,240709;于都,240710;会昌,240711;安远,240712;全南,240713;龙南,240714;定南,240715;寻乌,240716;兴国,240717;景德镇,240801;乐平,240802;萍乡,240901;莲花,240902;新余,241001;分宜,241002;鹰潭,241101;余江,241102;贵溪,241103;长沙,250101;宁乡,250102;浏阳,250103;马坡岭,250104;湘潭,250201;韶山,250202;湘乡,250203;株洲,250301;攸县,250302;醴陵,250303;株洲县,250304;茶陵,250305;炎陵,250306;衡阳,250401;衡山,250402;衡东,250403;祁东,250404;衡阳县,250405;常宁,250406;衡南,250407;耒阳,250408;南岳,250409;郴州,250501;桂阳,250502;嘉禾,250503;宜章,250504;临武,250505;桥口,250506;资兴,250507;汝城,250508;安仁,250509;永兴,250510;桂东,250511;常德,250601;安乡,250602;桃源,250603;汉寿,250604;澧县,250605;临澧,250606;石门,250607;益阳,250700;赫山区,250701;南县,250702;桃江,250703;安化,250704;沅江,250705;娄底,250801;双峰,250802;冷水江,250803;冷水滩,250804;新化,250805;涟源,250806;邵阳,250901;隆回,250902;洞口,250903;新邵,250904;邵东,250905;绥宁,250906;新宁,250907;武冈,250908;城步,250909;邵阳县,250910;岳阳,251001;华容,251002;湘阴,251003;汨罗,251004;平江,251005;临湘,251006;张家界,251101;桑植,251102;慈利,251103;怀化,251201;鹤城区,251202;沅陵,251203;辰溪,251204;靖州,251205;会同,251206;通道,251207;麻阳,251208;新晃,251209;芷江,251210;溆浦,251211;黔阳,251301;洪江,251302;永州,251401;祁阳,251402;东安,251403;双牌,251404;道县,251405;宁远,251406;江永,251407;蓝山,251408;新田,251409;江华,251410;吉首,251501;保靖,251502;永顺,251503;古丈,251504;凤凰,251505;泸溪,251506;龙山,251507;花垣,251508;贵阳,260101;白云,260102;花溪,260103;乌当,260104;息烽,260105;开阳,260106;修文,260107;清镇,260108;遵义,260201;遵义县,260202;仁怀,260203;绥阳,260204;湄潭,260205;凤冈,260206;桐梓,260207;赤水,260208;习水,260209;道真,260210;正安,260211;务川,260212;余庆,260213;汇川,260214;安顺,260301;普定,260302;镇宁,260303;平坝,260304;紫云,260305;关岭,260306;都匀,260401;贵定,260402;瓮安,260403;长顺,260404;福泉,260405;惠水,260406;龙里,260407;罗甸,260408;平塘,260409;独山,260410;三都,260411;荔波,260412;凯里,260501;岑巩,260502;施秉,260503;镇远,260504;黄平,260505;黄平旧洲,260506;麻江,260507;丹寨,260508;三穗,260509;台江,260510;剑河,260511;雷山,260512;黎平,260513;天柱,260514;锦屏,260515;榕江,260516;从江,260517;炉山,260518;铜仁,260601;江口,260602;玉屏,260603;万山,260604;思南,260605;塘头,260606;印江,260607;石阡,260608;沿河,260609;德江,260610;松桃,260611;毕节,260701;赫章,260702;金沙,260703;威宁,260704;大方,260705;纳雍,260706;织金,260707;六盘水,260801;六枝,260802;水城,260803;盘县,260804;黔西,260901;晴隆,260902;兴仁,260903;贞丰,260904;望谟,260905;兴义,260906;安龙,260907;册亨,260908;普安,260909;成都,270101;龙泉驿,270102;新都,270103;温江,270104;金堂,270105;双流,270106;郫县,270107;大邑,270108;蒲江,270109;新津,270110;都江堰,270111;彭州,270112;邛崃,270113;崇州,270114;崇庆,270115;彭县,270116;攀枝花,270201;仁和,270202;米易,270203;盐边,270204;自贡,270301;富顺,270302;荣县,270303;绵阳,270401;三台,270402;盐亭,270403;安县,270404;梓潼,270405;北川,270406;平武,270407;江油,270408;南充,270501;南部,270502;营山,270503;蓬安,270504;仪陇,270505;西充,270506;阆中,270507;达州,270601;宣汉,270602;开江,270603;大竹,270604;渠县,270605;万源,270606;达川,270607;遂宁,270701;蓬溪,270702;射洪,270703;广安,270801;岳池,270802;武胜,270803;邻水,270804;华蓥山,270805;巴中,270901;通江,270902;南江,270903;平昌,270904;泸州,271001;泸县,271003;合江,271004;叙永,271005;古蔺,271006;纳溪,271007;宜宾,271101;宜宾农试站,271102;宜宾县,271103;南溪,271104;江安,271105;长宁,271106;高县,271107;珙县,271108;筠连,271109;兴文,271110;屏山,271111;内江,271201;东兴,271202;威远,271203;资中,271204;隆昌,271205;资阳,271301;安岳,271302;乐至,271303;简阳,271304;乐山,271401;犍为,271402;井研,271403;夹江,271404;沐川,271405;峨边,271406;马边,271407;峨眉,271408;峨眉山,271409;眉山,271501;仁寿,271502;彭山,271503;洪雅,271504;丹棱,271505;青神,271506;凉山,271601;木里,271603;盐源,271604;德昌,271605;会理,271606;会东,271607;宁南,271608;普格,271609;西昌,271610;金阳,271611;昭觉,271612;喜德,271613;冕宁,271614;越西,271615;甘洛,271616;雷波,271617;美姑,271618;布拖,271619;雅安,271701;名山,271702;荣经,271703;汉源,271704;石棉,271705;天全,271706;芦山,271707;宝兴,271708;甘孜,271801;康定,271802;泸定,271803;丹巴,271804;九龙,271805;雅江,271806;道孚,271807;炉霍,271808;新龙,271809;德格,271810;白玉,271811;石渠,271812;色达,271813;理塘,271814;巴塘,271815;乡城,271816;稻城,271817;得荣,271818;阿坝,271901;汶川,271902;理县,271903;茂县,271904;松潘,271905;九寨沟,271906;金川,271907;小金,271908;黑水,271909;马尔康,271910;壤塘,271911;若尔盖,271912;红原,271913;南坪,271914;德阳,272001;中江,272002;广汉,272003;什邡,272004;绵竹,272005;罗江,272006;广元,272101;旺苍,272102;青川,272103;剑阁,272104;苍溪,272105;广州,280101;番禺,280102;从化,280103;增城,280104;花都,280105;天河,280106;韶关,280201;乳源,280202;始兴,280203;翁源,280204;乐昌,280205;仁化,280206;南雄,280207;新丰,280208;曲江,280209;惠州,280301;博罗,280302;惠阳,280303;惠东,280304;龙门,280305;梅州,280401;兴宁,280402;蕉岭,280403;大埔,280404;丰顺,280406;平远,280407;五华,280408;梅县,280409;汕头,280501;潮阳,280502;澄海,280503;南澳,280504;云澳,280505;南澎岛,280506;深圳,280601;珠海,280701;斗门,280702;黄茅洲,280703;佛山,280800;顺德,280801;三水,280802;南海,280803;肇庆,280901;广宁,280902;四会,280903;德庆,280905;怀集,280906;封开,280907;高要,280908;湛江,281001;吴川,281002;雷州,281003;徐闻,281004;廉江,281005;硇洲,281006;遂溪,281007;江门,281101;开平,281103;新会,281104;恩平,281105;台山,281106;上川岛,281107;鹤山,281108;河源,281201;紫金,281202;连平,281203;和平,281204;龙川,281205;清远,281301;连南,281302;连州,281303;连山,281304;阳山,281305;佛冈,281306;英德,281307;云浮,281401;罗定,281402;新兴,281403;郁南,281404;潮州,281501;饶平,281502;东莞,281601;中山,281701;阳江,281801;阳春,281802;揭阳,281901;揭西,281902;普宁,281903;惠来,281904;茂名,282001;高州,282002;化州,282003;电白,282004;信宜,282005;汕尾,282101;海丰,282102;陆丰,282103;遮浪,282104;东沙岛,282105;昆明,290101;昆明农试站,290102;东川,290103;寻甸,290104;晋宁,290105;宜良,290106;石林,290107;呈贡,290108;富民,290109;嵩明,290110;禄劝,290111;安宁,290112;太华山,290113;河口,290114;大理,290201;云龙,290202;漾鼻,290203;永平,290204;宾川,290205;弥渡,290206;祥云,290207;魏山,290208;剑川,290209;洱源,290210;鹤庆,290211;南涧,290212;红河,290301;石屏,290302;建水,290303;弥勒,290304;元阳,290305;绿春,290306;开远,290307;个旧,290308;蒙自,290309;屏边,290310;泸西,290311;金平,290312;曲靖,290401;沾益,290402;陆良,290403;富源,290404;马龙,290405;师宗,290406;罗平,290407;会泽,290408;宣威,290409;保山,290501;富宁,290502;龙陵,290503;施甸,290504;昌宁,290505;腾冲,290506;文山,290601;西畴,290602;马关,290603;麻栗坡,290604;砚山,290605;邱北,290606;广南,290607;玉溪,290701;澄江,290702;江川,290703;通海,290704;华宁,290705;新平,290706;易门,290707;峨山,290708;元江,290709;楚雄,290801;大姚,290802;元谋,290803;姚安,290804;牟定,290805;南华,290806;武定,290807;禄丰,290808;双柏,290809;永仁,290810;普洱,290901;景谷,290902;景东,290903;澜沧,290904;普洱,290905;墨江,290906;江城,290907;孟连,290908;西盟,290909;镇源,290910;镇沅,290911;宁洱,290912;昭通,291001;鲁甸,291002;彝良,291003;镇雄,291004;威信,291005;巧家,291006;绥江,291007;永善,291008;盐津,291009;大关,291010;临沧,291101;沧源,291102;耿马,291103;双江,291104;凤庆,291105;永德,291106;云县,291107;镇康,291108;怒江,291201;福贡,291203;兰坪,291204;泸水,291205;六库,291206;贡山,291207;香格里拉,291301;德钦,291302;维西,291303;中甸,291304;丽江,291401;永胜,291402;华坪,291403;宁蒗,291404;德宏,291501;潞江坝,291502;陇川,291503;盈江,291504;畹町镇,291505;瑞丽,291506;梁河,291507;潞西,291508;景洪,291601;大勐龙,291602;勐海,291603;景洪电站,291604;勐腊,291605;南宁,300101;南宁城区,300102;邕宁,300103;横县,300104;隆安,300105;马山,300106;上林,300107;武鸣,300108;宾阳,300109;硕龙,300110;崇左,300201;天等,300202;龙州,300203;凭祥,300204;大新,300205;扶绥,300206;宁明,300207;海渊,300208;柳州,300301;柳城,300302;沙塘,300303;鹿寨,300304;柳江,300305;融安,300306;融水,300307;三江,300308;来宾,300401;忻城,300402;金秀,300403;象州,300404;武宣,300405;桂林,300501;桂林农试站,300502;龙胜,300503;永福,300504;临桂,300505;兴安,300506;灵川,300507;全州,300508;灌阳,300509;阳朔,300510;恭城,300511;平乐,300512;荔浦,300513;资源,300514;梧州,300601;藤县,300602;太平,300603;苍梧,300604;蒙山,300605;岑溪,300606;贺州,300701;昭平,300702;富川,300703;钟山,300704;信都,300705;贵港,300801;桂平,300802;平南,300803;玉林,300901;博白,300902;北流,300903;容县,300904;陆川,300905;百色,301001;那坡,301002;田阳,301003;德保,301004;靖西,301005;田东,301006;平果,301007;隆林,301008;西林,301009;乐业,301010;凌云,301011;田林,301012;钦州,301101;浦北,301102;灵山,301103;河池,301201;天峨,301202;东兰,301203;巴马,301204;环江,301205;罗城,301206;宜州,301207;凤山,301208;南丹,301209;都安,301210;北海,301301;合浦,301302;涠洲岛,301303;防城港,301401;上思,301402;东兴,301403;板栏,301404;防城,301405;海口,310101;琼山,310102;三亚,310201;东方,310202;临高,310203;澄迈,310204;儋州,310205;昌江,310206;白沙,310207;琼中,310208;定安,310209;屯昌,310210;琼海,310211;文昌,310212;清兰,310213;保亭,310214;万宁,310215;陵水,310216;西沙,310217;珊瑚岛,310218;永署礁,310219;南沙岛,310220;乐东,310221;五指山,310222;通什,310223;香港,320101;九龙,320102;新界,320103;中环,320104;铜锣湾,320105;澳门,330101;台北县,340101;台北市,340102;高雄,340201;东港,340202;大武,340203;恒春,340204;兰屿,340205;台南,340301;台中,340401;桃园,340501;新竹县,340601;新竹市,340602;公馆,340603;宜兰,340701;马公,340801;东吉屿,340802;嘉义,340901;阿里山,340902;玉山,340903;新港,340904`.split(';').forEach(city => {
        const [name, id] = city.split(',');
        result[name] = id;
    });
    return result;
})();

const $tip = document.getElementById("tip");
const $cityid = document.getElementById("cityid");
function checkCity($input) {
    const name = $input.value.trim();
    $tip.classList.remove("error");
    if (!name) {
        $tip.innerText = "请输入城市名称";
        return;
    }
    const code = cityIds[name];
    if (!code) {
        $tip.classList.add("error");
        $tip.innerText = "未找到城市代码";
        return;
    }
    $tip.innerText = "已找到城市代码";
    $cityid.value = '101' + code;
}
)x";



const byte DNS_PORT = 53;//DNS端口号
IPAddress apIP(192, 168, 4, 1);//esp32-AP-IP地址
DNSServer dnsServer;//创建dnsServer实例
WebServer server(80);//创建WebServer

void handleRoot() {//访问主页回调函数
  server.send(200, "text/html", page_html);
}
void handleStyleCss() {// style.css
  server.send(200, "text/css", style_css);
}
void handleIndexJs() {// index.js
  server.send(200, "application/javascript", index_js);
}

static void sendConfigError(const String &message) {
  Serial.println("[config] rejected: " + message);
  server.send(400, "text/html", "<meta charset='UTF-8'>配置未保存：" + message);
}

static bool isDigits(const String &value) {
  if (value.length() == 0) return false;
  for (size_t i = 0; i < value.length(); ++i) {
    if (value[i] < '0' || value[i] > '9') return false;
  }
  return true;
}

static bool parseConfigInt(const String &value, int minValue, int maxValue, int &result) {
  if (!isDigits(value)) return false;
  const long parsed = value.toInt();
  if (parsed < minValue || parsed > maxValue) return false;
  result = static_cast<int>(parsed);
  return true;
}

static bool isLeapYear(int year) {
  return (year % 4 == 0 && year % 100 != 0) || year % 400 == 0;
}

static bool isValidDate(int year, int month, int day) {
  static const uint8_t daysPerMonth[] = {31, 28, 31, 30, 31, 30,
                                         31, 31, 30, 31, 30, 31};
  int maxDay = daysPerMonth[month - 1];
  if (month == 2 && isLeapYear(year)) maxDay = 29;
  return day >= 1 && day <= maxDay;
}

static bool isValidDeviceId(const String &id) {
  if (id.length() == 0 || id.length() > 16) return false;
  for (size_t i = 0; i < id.length(); ++i) {
    const char c = id[i];
    const bool alphaNumeric = (c >= 'a' && c <= 'z') ||
                              (c >= 'A' && c <= 'Z') ||
                              (c >= '0' && c <= '9');
    if (!alphaNumeric && c != '-' && c != '_') return false;
  }
  return true;
}

void handleRootPost() {//Post回调函数
  Serial.println("[config] POST received");

  if (!server.hasArg("ssid") || !server.hasArg("password") ||
      !server.hasArg("cityid") || !server.hasArg("year") ||
      !server.hasArg("month") || !server.hasArg("day") ||
      !server.hasArg("bottom") || !server.hasArg("self_id") ||
      !server.hasArg("peer_id")) {
    sendConfigError("表单字段不完整");
    return;
  }

  const String ssid = server.arg("ssid");
  const String password = server.arg("password");
  String submittedCityCode = server.arg("cityid");
  String yearText = server.arg("year");
  String monthText = server.arg("month");
  String dayText = server.arg("day");
  const String bottom = server.arg("bottom");
  String selfId = server.arg("self_id");
  String peerId = server.arg("peer_id");
  submittedCityCode.trim();
  yearText.trim();
  monthText.trim();
  dayText.trim();
  selfId.trim();
  peerId.trim();

  if (ssid.length() == 0 || ssid.length() > 32) {
    sendConfigError("WiFi 名称长度必须为 1 到 32 字节");
    return;
  }
  if (password.length() > 63) {
    sendConfigError("WiFi 密码不能超过 63 字节");
    return;
  }
  // 中国天气网城市代码为 9 位，例如烟台为 101120501。
  if (submittedCityCode.length() != 9 || !submittedCityCode.startsWith("101") ||
      !isDigits(submittedCityCode)) {
    sendConfigError("请选择列表中有效的城市");
    return;
  }
  if (!isValidDeviceId(selfId) || !isValidDeviceId(peerId)) {
    sendConfigError("设备 ID 须为 1 到 16 位字母、数字、短横线或下划线");
    return;
  }
  if (selfId == peerId) {
    sendConfigError("本机 ID 和对方 ID 不能相同");
    return;
  }
  if (bottom.length() > 128) {
    sendConfigError("底部文字不能超过 128 字节");
    return;
  }

  int year = 0;
  int month = 0;
  int day = 0;
  if (!parseConfigInt(yearText, 1970, 2099, year) ||
      !parseConfigInt(monthText, 1, 12, month) ||
      !parseConfigInt(dayText, 1, 31, day) ||
      !isValidDate(year, month, day)) {
    sendConfigError("纪念日日期无效");
    return;
  }

  Serial.printf("[config] validated: ssid=%s, password_length=%u, city=%s, self=%s, peer=%s\n",
                ssid.c_str(), static_cast<unsigned>(password.length()),
                submittedCityCode.c_str(), selfId.c_str(), peerId.c_str());

  if (!preferences.begin("wifi", false)) {
    sendConfigError("无法打开 WiFi 配置存储");
    return;
  }
  const size_t ssidWritten = preferences.putString("ssid", ssid);
  const size_t passwordWritten = preferences.putString("password", password);
  const size_t cityWritten = preferences.putString("citycode", submittedCityCode);
  const bool passwordWriteOk = password.length() == 0
                                   ? preferences.isKey("password")
                                   : passwordWritten == password.length();
  const bool wifiWriteOk = ssidWritten == ssid.length() && passwordWriteOk &&
                           cityWritten == submittedCityCode.length();
  preferences.end();

  if (!lovetv_prefs.begin("lovetv", false)) {
    sendConfigError("无法打开 LoveTV 配置存储");
    return;
  }
  const size_t yearWritten = lovetv_prefs.putInt("year", year);
  const size_t monthWritten = lovetv_prefs.putInt("month", month);
  const size_t dayWritten = lovetv_prefs.putInt("day", day);
  const size_t bottomWritten = lovetv_prefs.putString("bottom", bottom);
  const size_t selfIdWritten = lovetv_prefs.putString("self_id", selfId);
  const size_t peerIdWritten = lovetv_prefs.putString("peer_id", peerId);
  const bool bottomWriteOk = bottom.length() == 0
                                 ? lovetv_prefs.isKey("bottom")
                                 : bottomWritten == bottom.length();
  const bool loveTvWriteOk = yearWritten == sizeof(int32_t) &&
                             monthWritten == sizeof(int32_t) &&
                             dayWritten == sizeof(int32_t) && bottomWriteOk &&
                             selfIdWritten == selfId.length() &&
                             peerIdWritten == peerId.length();
  lovetv_prefs.end();

  bool verified = wifiWriteOk && loveTvWriteOk;
  if (verified && preferences.begin("wifi", true)) {
    verified = preferences.getString("ssid", "") == ssid &&
               preferences.getString("password", "") == password &&
               preferences.getString("citycode", "") == submittedCityCode;
    preferences.end();
  } else {
    verified = false;
  }
  if (verified && lovetv_prefs.begin("lovetv", true)) {
    verified = lovetv_prefs.getInt("year", -1) == year &&
               lovetv_prefs.getInt("month", -1) == month &&
               lovetv_prefs.getInt("day", -1) == day &&
               lovetv_prefs.getString("bottom", "") == bottom &&
               lovetv_prefs.getString("self_id", "") == selfId &&
               lovetv_prefs.getString("peer_id", "") == peerId;
    lovetv_prefs.end();
  } else {
    verified = false;
  }

  if (!verified) {
    sendConfigError("写入后校验失败，请重新提交");
    return;
  }

  Serial.println("[config] NVS write and read-back verification succeeded");
  server.send(200, "text/html", "<meta charset='UTF-8'>保存成功，ESP32桌面小电视重启中...");
  delay(2000);
  ESP.restart(); //重启ESP32
}

void initBasic(void){//初始化基础
  WiFi.hostname("Smart-ESP32");//设置ESP32设备名
}

void initSoftAP(void){//初始化AP模式
  WiFi.mode(WIFI_AP);
  WiFi.softAPConfig(apIP, apIP, IPAddress(255, 255, 255, 0));
  if(WiFi.softAP(AP_NAME)){
    Serial.println("ESP32 SoftAP is right");
  }
}

void initWebServer(void){//初始化WebServer
  //server.on("/",handleRoot);
  //上面那行必须以下面这种格式去写否则无法强制门户
  server.on("/", HTTP_GET, handleRoot);//设置主页回调函数
  server.on("/index.js", HTTP_GET, handleIndexJs);
  server.on("/style.css", HTTP_GET, handleStyleCss);
  server.onNotFound(handleRoot);//设置无法响应的http请求的回调函数
  server.on("/", HTTP_POST, handleRootPost);//设置Post请求回调函数
  server.begin();//启动WebServer
  Serial.println("WebServer started!");
}

void initDNS(void){//初始化DNS服务器
  if(dnsServer.start(DNS_PORT, "*", apIP)){//判断将所有地址映射到esp8266的ip上是否成功
    Serial.println("start dnsserver success.");
  }
  else Serial.println("start dnsserver failed.");
}

void connectNewWifi(void){
  WiFi.mode(WIFI_STA);//切换为STA模式
 // WiFi.setAutoConnect(true);//设置自动连接
  WiFi.begin(PrefSSID.c_str(), PrefPassword.c_str());//连接上一次连接成功的wifi
  Serial.println("");
  Serial.print("Connect to wifi");
  int count = 0;
   while (WiFi.status() != WL_CONNECTED) {
    delay(500);
    count++;
    if(count > 20){//如果10秒内没有连上，就开启Web配网 可适当调整这个时间
      initSoftAP();
      initWebServer();
      initDNS();
      break;//跳出 防止无限初始化
    }
    Serial.print(".");
  }
  Serial.println("");
  if(WiFi.status() == WL_CONNECTED){
    Serial.println("WIFI Connected!");
    Serial.print("IP address: ");
    Serial.println(WiFi.localIP());
    server.stop();
  }
}
